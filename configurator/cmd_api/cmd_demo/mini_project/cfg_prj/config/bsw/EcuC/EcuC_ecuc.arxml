AUTOSAR XML (schema 00046)
package /ActiveEcuC
  module config EcuC: implementation-config-variant=VARIANT-PRE-COMPILE, module-description=Com_Impl
    EcucConfigSet
      EcucPduCollection: PduIdTypeEnum=UINT8, PduLengthTypeEnum=UINT8
        MetaDataType
          MetaDataItem: MetaDataItemLength=1, MetaDataItemType=CAN_ID_32
    EcucHardware
      6 x EcucCoreDefinition:
        EcucCoreDefinition{0..5}: EcucCoreId={0..5}, EcucCoreHwRef=/ActiveEcuC/Os/TriCore397/OsDerivativeInformation/OsPhysicalCore{0..5}
    EcucPartitionCollection
      6 x EcucPartition, all with EcucPartitionBswModuleExecution=false, EcucPartitionQmBswModuleExecution=false, PartitionCanBeRestarted=false, ASIL=QM, EcucPartitionSoftwareComponentInstanceRef=(unset):
        EcucPartition_0: EcucPartitionBswModuleDistinguishedPartition=
        EcucPartition_{1..5}: EcucPartitionBswModuleDistinguishedPartition=(unset)
