AUTOSAR XML (schema 00046)
package /InitialEcuC
  module config CanIf
    CanIfDispatchCfg:
      CanIfDispatchUserCtrlBusOffName = CanSM_ControllerBusOff
      CanIfDispatchUserCtrlBusOffUL = CAN_SM
      CanIfDispatchUserCtrlModeIndicationName = CanSM_ControllerModeIndication
      CanIfDispatchUserCtrlModeIndicationUL = CAN_SM
      CanIfDispatchUserTrcvModeIndicationName = CanSM_TransceiverModeIndication
      CanIfDispatchUserTrcvModeIndicationUL = CAN_SM
      CanIfDispatchUserCheckTrcvWakeFlagIndicationName = CanSM_CheckTransceiverWakeFlagIndication
      CanIfDispatchUserCheckTrcvWakeFlagIndicationUL = CAN_SM
      CanIfDispatchUserClearTrcvWufFlagIndicationName = CanSM_ClearTrcvWufFlagIndication
      CanIfDispatchUserClearTrcvWufFlagIndicationUL = CAN_SM
      CanIfDispatchUserConfirmPnAvailabilityName = CanSM_ConfirmPnAvailability
      CanIfDispatchUserConfirmPnAvailabilityUL = CAN_SM
    CanIfInitCfg
      CanIfInitHohCfg: CanIfInitRefCfgSet=CanConfigSet
    CanIfPrivateCfg:
      CanIfPrivateDlcCheck = true
      CanIfSupportTTCAN = false
      CanIfTransceiverMapping = false
      CanIfTransceiverHandling = true
      CanIfSupportExtendedIds = true
      CanIfSupportNmOsek = false
      CanIfWakeupSupport = false
      CanIfStaticFdTxBufferSupport = true
      CanIfRxSearchConsiderMsgType = true
      CanIfTxBufferFifoSupport = false
      CanIfSetPduReceptionModeSupport = false
      CanIfCheckWakeupCanRetType = false
      CanIfDataChecksumRxSupport = false
      CanIfDataChecksumTxSupport = false
      CanIfPrivateSoftwareFilterType = LINEAR
      CanIfTxBufferType = BYTE_QUEUE
    CanIfPublicCfg:
      CanIfPublicPnSupport = false
      CanIfPublicCancelTransmitSupport = true
      CanIfPublicDevErrorDetect = false
      CanIfPublicMultipleDrvSupport = false
      CanIfPublicNumberOfCanHwUnits = 1
      CanIfPublicReadRxPduDataApi = true
      CanIfPublicReadRxPduNotifyStatusApi = true
      CanIfPublicReadTxPduNotifyStatusApi = true
      CanIfPublicSetDynamicTxIdApi = true
      CanIfPublicTxBuffering = true
      CanIfPublicTxConfirmPollingSupport = true
      CanIfPublicVersionInfoApi = true
      CanIfPublicWakeupCheckValidSupport = false
      CanIfPnWakeupTxPduFilterSupport = true
      CanIfPnTrcvHandlingSupport = true
      CanIfSafeBswChecks = true
      CanIfBusMirroringSupport = true
      CanIfEnableSecurityEventReporting = true
      CanIfSupportCanDrvAsr440 = true
      CanIfSetBaudrateApi = true
      CanIfExtendedRamCheckSupport = true
      CanIfPublicHandleTypeEnum = UINT8
      CanIfJ1939DynAddrSupport = DISABLED
      CanIfPublicCddHeaderFile = a.h
    CanIfTrcvDrvCfg
      CanIfTrcvCfg: CanIfTrcvId=0, CanIfTrcvWakeupSupport=true, CanIfTrcvCanTrcvRef=CanTrcvChannel_1
    CanIfCtrlDrvCfg:
      CanIfCtrlDrvTxCancellation = false
      CanIfRxIndicationPrototype = CANIF_RX_IND_ASR422
      CanIfCtrlDrvInitHohConfigRef = (unset)
      CanIfCtrlDrvNameRef = (unset)
  module config CanNm
    CanNmGlobalConfig:
      CanNmBusLoadReductionEnabled = false
      CanNmBusSynchronizationEnabled = false
      CanNmComControlEnabled = true
      CanNmComUserDataSupport = true
      CanNmCoordinatorSyncSupport = false
      CanNmDevErrorDetect = false
      CanNmGlobalPnSupport = false
      CanNmImmediateRestartEnabled = false
      CanNmImmediateTxconfEnabled = false
      CanNmPassiveModeEnabled = false
      CanNmPduRxIndicationEnabled = false
      CanNmPnEiraCalcEnabled = false
      CanNmRemoteSleepIndEnabled = false
      CanNmStateChangeIndEnabled = true
      CanNmUserDataEnabled = true
      CanNmVersionInfoApi = false
      CanNmMainFunctionPeriod = 0.01
      CanNmPnResetTime = 1.95
      CanNmPnEiraRxNSduRef = 
      CanNmPnInfo: CanNmPnInfoLength=1, CanNmPnInfoOffset=1
      CanNm_MainFunction (CanNmMainFunction): CanNmMainFunctionPeriod=0.005
  module config CanSM
    CanSMGeneral:
      CanSMDevErrorDetect = false
      CanSMIcomSupport = false
      CanSMPncSupport = false
      CanSMSetBaudrateApi = false
      CanSMTxOfflineActiveSupport = false
      CanSMVersionInfoApi = false
      CanSMMainFunctionTimePeriod = (unset)
      CanSMGetBusOffDelayFunction = (unset)
      BusOffBeginFunction = (unset)
      BusOffEndFunction = (unset)
      CanSMGetBusOffDelayHeader = (unset)
    CanSMConfiguration: CanSMModeRequestRepetitionTime=(unset), CanSMModeRequestRepetitionMax=(unset)
      CanSM_MainFunction (CanSMMainFunction): CanSMMainFunctionPeriod=0.005
  module config CanTp
    CanTpConfig: CanTpMainFunctionPeriod=0.005, CanTpMaxChannelCnt=1
    CanTpGeneral:
      CanTpChangeParameterApi = false
      CanTpDevErrorDetect = false
      CanTpDynIdSupport = false
      CanTpFlexibleDataRateSupport = false
      CanTpGenericConnectionSupport = false
      CanTpReadParameterApi = false
      CanTpVersionInfoApi = false
      CanTpPaddingByte = 85
  module config Dcm
    DcmConfigSet
  module config Com
    ComConfig: ComDataMemSize=0, ComMaxIPduCnt=0
      Com_MainFunction_Rx (ComMainFunctionRx): MainRxTimeBase=0.005
      Com_MainFunction_Tx (ComMainFunctionTx): MainTxTimeBase=0.005
      Com_MainFunction_Gw (ComMainFunctionGw): MainGwTimeBase=0.005
    ComGeneral:
      ComCancellationSupport = true
      ComConfigurationUseDet = false
      ComEnableMDTForCyclicTransmission = true
      ComEnableSignalGroupArrayApi = false
      ComMetaDataSupport = false
      ComRetryFailedTransmitRequests = false
      ComVersionInfoApi = false
      ComSupportedIPduGroups = 0
      ComUserCbkHeaderFile = (unset)
  module config ComM
    ComMGeneral:
      ComM0PncVectorAvoidance = false
      ComMDevErrorDetect = false
      ComMDirectUserMapping = false
      ComMModeLimitationEnabled = false
      ComMPncGatewayEnabled = false
      ComMPncSupport = false
      ComMResetAfterForcingNoComm = false
      ComMSynchronousWakeUp = true
      ComMVersionInfoApi = false
      ComMWakeupInhibitionEnabled = false
      ComMPncPrepareSleepTimer = 0
      ComMTMinFullComModeDuration = 5
      ComMEcuGroupClassification = 3
      ComMGlobalNvMBlockDescriptor = <empty>
    ComMConfigSet: ComMPncEnabled=false
  module config EcuC
    EcucConfigSet
      EcucPduCollection: PduIdTypeEnum=UINT8, PduLengthTypeEnum=UINT8
        MetaDataType
          MetaDataItem: MetaDataItemLength=1, MetaDataItemType=CAN_ID_32
    EcucHardware
      EcucCoreDefinition: EcucCoreId=0, EcucCoreHwRef=
    EcucPartitionCollection
      EcucPartition:
        EcucPartitionBswModuleExecution = false
        EcucPartitionQmBswModuleExecution = true
        PartitionCanBeRestarted = false
        EcucPartitionSoftwareComponentInstanceRef = (unset)
        EcucPartitionBswModuleDistinguishedPartition = 
    EcucPostBuildVariants: EcucPostBuildVariantRef=
    EcucUnitGroupAssignment: EcucUnitGroupRef=
    EcucVariationResolver: PredefinedVariantRef=
  module config EcuM
    EcuMGeneral: EcuMDevErrorDetect=false, EcuMIncludeDet=false, EcuMVersionInfoApi=false, EcuMMainFunctionPeriod=0.01
    EcuMFlexGeneral:
      EcuMAlarmClockPresent = false
      EcuMModeHandling = false
      EcuMResetLoopDetection = false
      EcuMSetProgrammableInterrupts = false
      EcuMAlarmWakeupSource = <empty>
    EcuMConfiguration
      EcuMCommonConfiguration: EcuMConfigConsistencyHash=1431677610, EcuMDefaultAppMode=/ActiveEcuC/Os/OSDEFAULTAPPMODE, EcuMOSResource=/ActiveEcuC/Os/OsResource_Core0
        EcuMDefaultShutdownTarget: EcuMDefaultShutdownTarget=EcuMShutdownTargetOff, EcuMDefaultResetModeRef=<empty>, EcuMDefaultSleepModeRef=<empty>
        EcuMDriverInitListZero
        EcuMDriverInitListOne
        EcuMDriverRestartList
      EcuMFlexConfiguration: EcuMNormalMcuModeRef=<empty>, EcuMPartitionRef=<empty>
  module config LinIf
    LinIfGeneral:
      LinIfCancelTransmitSupported = (unset)
      LinIfDevErrorDetect = true
      LinIfMultipleDriversSupported = false
      LinIfMultipleTrcvDriverSupported = false
      LinIfNcOptionalRequestSupported = false
      LinIfTpSupported = true
      LinIfTrcvDriverSupported = false
      LinIfVersionInfoApi = false
      LinIfBusMirroringSupported = false
    LinIfGlobalConfig: LinIfTimeBase=0.005
  module config LinSM
    LinSMConfigSet
    LinSMGeneral: LinSMDevErrorDetect=(unset), LinSMMainProcessingPeriod=0.01, LinSMVersionInfoApi=(unset)
  module config LinTp
    LinTpGeneral: LinTpVersionInfoApi=(unset)
    LinTpGlobalConfig: LinTpMaxNumberOfRespPendingFrames=(unset), LinTpNumberOfRxNSdu=(unset), LinTpNumberOfTxNSdu=(unset), LinTpP2Max=(unset), LinTpP2Timing=(unset)
  module config Nm
    NmGlobalConfig
      NmGeneration:
        NmOutOfBoundsWriteSanitizer = false
        NmOutOfBoundsReadSanitizer = false
        NmShortSymbols = false
        NmInterfacesForDeactivatedData = false
        NmReferringKeysInComments = false
      NmGlobalFeatures:
        NmBusSynchronizationEnabled = false
        NmCarWakeUpRxEnabled = false
        NmComControlEnabled = true
        NmCoordinatorSupportEnabled = false
        NmCoordinatorSyncSupport = false
        NmPduRxIndicationEnabled = false
        NmRemoteSleepIndEnabled = false
        NmStateChangeIndEnabled = true
        NmUserDataEnabled = true
        NmGlobalCoordinatorTime = 0
        NmCarWakeUpCallout = 
      NmGlobalConstants: NmNumberOfChannels=1
      NmGlobalProperties: NmDevErrorDetect=true, NmVersionInfoApi=false, NmCycletimeMainFunction=0
    4 x NmChannelConfig, all with NmActiveCoordinator=false, NmChannelSleepMaster=false, NmComUserDataSupport=false, NmStateReportEnabled=false, NmSynchronizingNetwork=false, NmCoordClusterIndex=0, NmStateReportSignalRef=<empty>:
      COMM_NETWORK_HANDLE_CAN1: NmPassiveModeEnabled=true, NmComMChannelRef=/ActiveEcuC/ComM/ComMConfigSet/COMM_NETWORK_HANDLE_CAN1
        NmBusType
          NmStandardBusNmConfig: NmStandardBusType=NM_BUSNM_CANNM
      COMM_NETWORK_HANDLE_ETH1: NmPassiveModeEnabled=true, NmComMChannelRef=/ActiveEcuC/ComM/ComMConfigSet/COMM_NETWORK_HANDLE_ETH1
        NmBusType
          NmStandardBusNmConfig: NmStandardBusType=NM_BUSNM_UDPNM
      COMM_NETWORK_HANDLE_CAN2: NmPassiveModeEnabled=false, NmComMChannelRef=/ActiveEcuC/ComM/ComMConfigSet/COMM_NETWORK_HANDLE_CAN2
        NmBusType
          NmStandardBusNmConfig: NmStandardBusType=NM_BUSNM_CANNM
      COMM_NETWORK_HANDLE_CAN3: NmPassiveModeEnabled=false, NmComMChannelRef=/ActiveEcuC/ComM/ComMConfigSet/COMM_NETWORK_HANDLE_CAN3
        NmBusType
          NmStandardBusNmConfig: NmStandardBusType=NM_BUSNM_CANNM
  module config PduR
    PduRGeneral:
      PduRDevErrorDetect = false
      PduRMetaDataSupport = false
      PduRMainFunctionPeriod = 0.001
      PduRSpinlockRetryCounter = 3
      PduRVersionInfoApi = false
      PduRZeroCostOperation = false
    PduRRoutingPaths: PduRConfigurationId=0, PduRMaxRoutingPathCnt=113, PduRMaxRoutingPathGroupCnt=113
  ecuc value collection InitialEcuC: ecuc-values=[Can, CanIf, CanNm, CanSM, CanTp, Com, ComM, EcuC, EcuM, Lin, LinIf, LinSM, LinTp, Nm, PduR]
