AUTOSAR XML (schema 00048)
package /VehicleProject
  system System
