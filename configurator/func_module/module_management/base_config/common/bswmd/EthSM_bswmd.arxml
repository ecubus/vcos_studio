AUTOSAR XML (schema 00046)
package /AUTOSAR/EcucDefs
  module definition EthSM [0..1]: variants pre-compile  # Configuration of the Ethernet State Manager
    container EthSMGeneral  # This container contains the global parameter of the Ethernet State Manager.
      boolean EthSMDevErrorDetect: set at pre-compile, default-value=false  # Switches the development error detection and notification on or off. | * true: detection and notification is enabled. * false: detection and notification is disabled.
      boolean EthSMDummyMode: set at pre-compile  # Disables the API to the EthIf. The API to the ComM is available but the functionality is deactivated. The function calls from the ComM will be answered with the return value E_OK.
      boolean EthSMVersionInfoApi: set at pre-compile, default-value=false  # Enables and disables the version info API.
      float EthSMMainFunctionPeriod: 0..100, set at pre-compile  # Specifies the period in seconds that the MainFunction has to be triggered with.
    container EthSMNetwork [1..254]  # This container contains the Ethernet network-specific parameters of each Ethernet network. It also contains the reference to combination of controller and transceiver assigned to an Ethernet network.
      reference EthSMComMNetworkHandleRef: set at pre-compile, requires-symbolic-name-value=true, destination=ComMChannel  # Unique handle to identify one certain Ethernet network. Reference to one of the network handles configured for the ComM.
      reference EthSMEthIfControllerRef: set at pre-compile, requires-symbolic-name-value=true, destination=EthIfController  # Reference to EthIfCtrl container where a ETH controller and | transceiver (optional) combination is configured.
      container EthSMDemEventParameterRefs [0..1]  # Container for the references to DemEventParameter elements which shall be invoked using the API Dem_SetEventStatus in case the corresponding error occurs. The EventId is taken from the referenced DemEventParameter's DemEventId symbolic value. The standardized errors are provided in this container and can be extended by vendor-specific error references.
        reference ETHSM_E_LINK_DOWN [0..1]: multiplicity set at pre-compile, set at pre-compile, requires-symbolic-name-value=true, destination=DemEventParameter  # Reference to configured DEM event to report bus off errors for this Eth network.
package /AUTOSAR/EcucDestinationUriDefSets
  ecuc destination uri def set RteRipsUriDefSet
    ecuc destination uri def RteRipsInvocationHandler
      destination-uri-policy destination-uri-nesting-contract=TARGET-CONTAINER:
        container RteRipsInvocationHandlerFnc [0..*]  # This container describes an invocation handler function implemented by an RTE Implementation Plug-In to handle the invocation of server runnables and triggered runnables via a transformer. Tags: atp.Status=draft
          function name RteRipsInvocationHandlerFncSymbol  # C-Symbol of the Rte_Rips_FillFlushRoutine function. Tags: atp.Status=draft
    ecuc destination uri def RteRipsPlugin
      destination-uri-policy destination-uri-nesting-contract=TARGET-CONTAINER:
        container RteRipsPluginProps  # This container defines the identity of the Rte Implementation Plug-in and provides the RTE relevant parameters of the Rte Implementation Plug-in. Tags: atp.Status=draft | The shortName of the container defines the name of the Rte Implementation Plug-in used for the API infixes.
          boolean RtePluginSupportsIReadIWrite: default-value=false  # Denotes if or if not the plug-in supports the Rte_Rips_IRead/IWrite macros for primitive data. Tags: atp.Status=draft
          enumeration RteRipsGlobalCopyInstantiationPolicy: {RTE_RIPS_INSTANTIATION_BY_PLUGIN, RTE_RIPS_INSTANTIATION_BY_RTE}, default-value=RTE_RIPS_INSTANTIATION_BY_RTE  # Globally enables or disables the support for Rte Implementation Plug-Ins (RIPS) Tags: atp.Status=draft
    ecuc destination uri def RteRipsPluginFillFlushRoutine
      destination-uri-policy destination-uri-nesting-contract=TARGET-CONTAINER:
        container RteRipsPluginFillFlushRoutineFnc [0..*]  # This container describes a Fill-Flush Routine function implemented by a RTE Implementation Plug-In to handle the buffering for implicit communication. Tags: atp.Status=draft
          enumeration RteRipsModeDisablingHandling: {RTE_RIPS_CONSIDER_MODE_DISABLINGS, RTE_RIPS_IGNORE_MODE_DISABLINGS}  # This parameter configures whether mode disabling dependencies are considered for the invocation of Rte_Rips_FillFlushRoutines. Tags: atp.Status=draft
          enumeration RteRipsOsSchedulePoint [0..1]: {NONE, UNCONDITIONAL}  # Introduce a schedule point by explicitly calling Os Schedule service after the execution of the Rte_Rips_FillFlushRoutine. Tags: atp.Status=draft
          function name RteRipsPluginFillFlushRoutineFncSymbol  # C-Symbol of the Rte_Rips_FillFlushRoutine function. Tags: atp.Status=draft
package /AUTOSAR/LifeCycleInfoSets
  life cycle info set AUTOSARParameterDefinition
    life-cycle-infos:
      lc-object=AdcGroupEcucPartitionRef, lc-state=draft
      lc-object=AdcEcucPartitionRef, lc-state=draft
      lc-object=AdcKernelEcucPartitionRef, lc-state=draft
      lc-object=ArtiConstant, lc-state=draft
      lc-object=ArtiConstantString, lc-state=draft
      lc-object=ArtiExpression, lc-state=draft
      lc-object=ArtiExpressionString, lc-state=draft
      lc-object=ArtiHook, lc-state=draft
      lc-object=ArtiHookClass, lc-state=draft
      lc-object=ArtiHookEventName, lc-state=draft
      lc-object=ArtiHookInstance, lc-state=draft
      lc-object=ArtiHookEventParameterTypeRef, lc-state=draft
      lc-object=ArtiHookInstanceParameterTypeRef, lc-state=draft
      lc-object=ArtiObjectClassParameter, lc-state=draft
      lc-object=ArtiParameterTypeMapRef, lc-state=draft
      lc-object=ArtiObjectInstanceParameter, lc-state=draft
      lc-object=ArtiConstantRef, lc-state=draft
      lc-object=ArtiExpressionRef, lc-state=draft
      lc-object=ArtiHookRef, lc-state=draft
      lc-object=ArtiParameterTypeMap, lc-state=draft
      lc-object=ArtiParameterTypeMapPair, lc-state=draft
      lc-object=ArtiParameterTypeMapPairInput, lc-state=draft
      lc-object=ArtiParameterTypeMapPairOutput, lc-state=draft
      lc-object=ArtiGenericComponentClass, lc-state=draft
      lc-object=ArtiGenericComponentClassName, lc-state=draft
      lc-object=ArtiGenericComponentClassParameter, lc-state=draft
      lc-object=ArtiGenericComponentClassParameterName, lc-state=draft
      lc-object=ArtiParameterTypeMapRef, lc-state=draft
      lc-object=ArtiGenericComponentInstance, lc-state=draft
      lc-object=ArtiGenericComponentInstanceName, lc-state=draft
      lc-object=ArtiGenericComponentClassRef, lc-state=draft
      lc-object=ArtiGenericComponentInstanceParameter, lc-state=draft
      lc-object=ArtiConstantRef, lc-state=draft
      lc-object=ArtiExpressionRef, lc-state=draft
      lc-object=ArtiGenericComponentClassParameterRef, lc-state=draft
      lc-object=ArtiHookRef, lc-state=draft
      lc-object=ArtiHwCoreClass, lc-state=draft
      lc-object=ArtiCurrentApplicationClassRef, lc-state=draft
      lc-object=ArtiCurrentTaskClassRef, lc-state=draft
      lc-object=ArtiLastErrorClassRef, lc-state=draft
      lc-object=ArtiHwCoreInstance, lc-state=draft
      lc-object=ArtiCurrentApplicationInstanceRef, lc-state=draft
      lc-object=ArtiCurrentTaskInstanceRef, lc-state=draft
      lc-object=ArtiEcucCoreRef, lc-state=draft
      lc-object=ArtiLastErrorInstanceRef, lc-state=draft
      lc-object=ArtiOsClass, lc-state=draft
      lc-object=ArtiOsAppModeClassRef, lc-state=draft
      lc-object=ArtiOsInstance, lc-state=draft
      lc-object=ArtiOsAppModeEcucRef, lc-state=draft
      lc-object=ArtiOsAppModeInstanceRef, lc-state=draft
      lc-object=ArtiOsEcucRef, lc-state=draft
      lc-object=ArtiOsTaskHookRef, lc-state=draft
      lc-object=ArtiOsTaskClass, lc-state=draft
      lc-object=ArtiOsTaskInstance, lc-state=draft
      lc-object=ArtiGenericComponentInstanceRef, lc-state=draft
      lc-object=ArtiOsTaskEcucRef, lc-state=draft
      lc-object=CanControllerEcucPartitionRef, lc-state=draft
      lc-object=CanTTControllerEcucPartitionRef, lc-state=draft
      lc-object=CanEcucPartitionRef, lc-state=draft
      lc-object=CanTSynGlobalTimeSecureTmacLength, lc-state=draft
      lc-object=CanTSynTxTmacCalculated, lc-state=draft
      lc-object=CanTSynGlobalTimeMinMsgGap, lc-state=draft
      lc-object=CanTSynRxTmacValidated, lc-state=draft
      lc-object=CanTrcvChannelEcucPartitionRef, lc-state=draft
      lc-object=CanTrcvEcucPartitionRef, lc-state=draft
      lc-object=CorTstBackgroundEcucPartitionRef, lc-state=draft
      lc-object=CorTstForegroundEcucPartitionRef, lc-state=draft
      lc-object=CorTstEcucPartitionRef, lc-state=draft
      lc-object=CryptoDriverObjectEcucPartitionRef, lc-state=draft
      lc-object=CryptoEcucPartitionRef, lc-state=draft
      lc-object=DemFreezeFrameRecordTrigger, lc-state=draft
      lc-object=DioPortEcucPartitionRef, lc-state=draft
      lc-object=DioChannelEcucPartitionRef, lc-state=draft
      lc-object=DioChannelGroupEcucPartitionRef, lc-state=draft
      lc-object=DioEcucPartitionRef, lc-state=draft
      lc-object=EepEcucPartitionRef, lc-state=draft
      lc-object=EthCtrlEcucPartitionRef, lc-state=draft
      lc-object=EthEcucPartitionRef, lc-state=draft
      lc-object=EthSwtConfigEcucPartitionRef, lc-state=draft
      lc-object=EthSwtEcucPartitionRef, lc-state=draft
      lc-object=EthTSynGlobalTimeSecureTmacLength, lc-state=draft
      lc-object=EthTSynGlobalTimeMinMsgGap, lc-state=draft
      lc-object=EthTSynTxTmacCalculated, lc-state=draft
      lc-object=EthTSynRxTmacValidated, lc-state=draft
      lc-object=EthTrcvConfigEcucPartitionRef, lc-state=draft
      lc-object=EthTrcvEcucPartitionRef, lc-state=draft
      lc-object=FlsEcucPartitionRef, lc-state=draft
      lc-object=FlsTstEcucPartitionRef, lc-state=draft
      lc-object=FrEcucPartitionRef, lc-state=draft
      lc-object=FrCtrlEcucPartitionRef, lc-state=draft
      lc-object=FrTSynGlobalTimeSecureTmacLength, lc-state=draft
      lc-object=FrTSynUseExtendedMsgFormat, lc-state=draft
      lc-object=FrTSynTxTmacCalculated, lc-state=draft
      lc-object=FrTSynGlobalTimeMinMsgGap, lc-state=draft
      lc-object=FrTSynGlobalTimeTmacTimeout, lc-state=draft
      lc-object=FrTSynRxTmacValidated, lc-state=draft
      lc-object=FrTrcvChannelEcucPartitionRef, lc-state=draft
      lc-object=FrTrcvEcucPartitionRef, lc-state=draft
      lc-object=GptChannelEcucPartitionRef, lc-state=draft
      lc-object=GptEcucPartitionRef, lc-state=draft
      lc-object=GptKernelEcucPartitionRef, lc-state=draft
      lc-object=IcuChannelEcucPartitionRef, lc-state=draft
      lc-object=IcuEcucPartitionRef, lc-state=draft
      lc-object=IcuKernelEcucPartitionRef, lc-state=draft
      lc-object=IpduMContainedPduOffset, lc-state=draft
      lc-object=IpduMPduUpdateBitPosition, lc-state=draft
      lc-object=IpduMContainedPduOffset, lc-state=draft
      lc-object=IpduMPduUpdateBitPosition, lc-state=draft
      lc-object=IPDUM_HEADERTYPE_NONE, lc-state=draft
      lc-object=IPDUM_HEADERTYPE_NONE, lc-state=draft
      lc-object=IpduMUnusedAreasDefault, lc-state=draft
      lc-object=LinEcucPartitionRef, lc-state=draft
      lc-object=LinChannelEcucPartitionRef, lc-state=draft
      lc-object=LinTrcvChannelEcucPartitionRef, lc-state=draft
      lc-object=LinTrcvEcucPartitionRef, lc-state=draft
      lc-object=McuEcucPartitionRef, lc-state=draft
      lc-object=OcuChannelEcucPartitionRef, lc-state=draft
      lc-object=OcuEcucPartitionRef, lc-state=draft
      lc-object=OcuKernelEcucPartitionRef, lc-state=draft
      lc-object=PortPinEcucPartitionRef, lc-state=draft
      lc-object=PortEcucPartitionRef, lc-state=draft
      lc-object=PwmChannelEcucPartitionRef, lc-state=draft
      lc-object=PwmEcucPartitionRef, lc-state=draft
      lc-object=PwmKernelEcucPartitionRef, lc-state=draft
      lc-object=RamTstEcucPartitionRef, lc-state=draft
      lc-object=RamTstBlockParamsEcucPartitionRef, lc-state=draft
      lc-object=RteRipsFillRoutineRef, lc-state=draft
      lc-object=RteRipsFlushRoutineRef, lc-state=draft
      lc-object=RteBswExclusiveAreaResponsibleRipsPluginRef, lc-state=draft
      lc-object=RteModeMachineInstanceResponsibleRipsPluginRef, lc-state=draft
      lc-object=RteDSMQResponsibleRipsPluginRef, lc-state=draft
      lc-object=RteRips, lc-state=draft
      lc-object=RteRipsSupport, lc-state=draft
      lc-object=RteRipsPluginConfigurationRef, lc-state=draft
      lc-object=RteRipsFillRoutineRef, lc-state=draft
      lc-object=RteRipsFlushRoutineRef, lc-state=draft
      lc-object=RteRipsInvocationHandlerRef, lc-state=draft
      lc-object=RteExclusiveAreaResponsibleRipsPluginRef, lc-state=draft
      lc-object=RteModeMachineInstanceResponsibleRipsPluginRef, lc-state=draft
      lc-object=SoAdSocketTcpTlsConnectionRef, lc-state=draft
      lc-object=SpiDeviceEcucPartitionRef, lc-state=draft
      lc-object=SpiEcucPartitionRef, lc-state=draft
      lc-object=SpiKernelEcucPartitionRef, lc-state=draft
      lc-object=TcpIpTlsConfig, lc-state=draft
      lc-object=TcpIpTlsMaxConnections, lc-state=draft
      lc-object=TcpIpTlsCsmRandomGenerateJobRef, lc-state=draft
      lc-object=TcpIpTlsCiphersuites, lc-state=draft
      lc-object=TcpIpTlsCertificateIdentity, lc-state=draft
      lc-object=TcpIpTlsServerNameIdentification, lc-state=draft
      lc-object=TcpIpTlsCiphersuiteDefinition, lc-state=draft
      lc-object=TcpIpTlsCiphersuiteId, lc-state=draft
      lc-object=TcpIpTlsCiphersuiteName, lc-state=draft
      lc-object=TcpIpTlsCiphersuitePriority, lc-state=draft
      lc-object=TcpIpTlsUseAEADCipher, lc-state=draft
      lc-object=TcpIpTlsUsePresharedKeys, lc-state=draft
      lc-object=TcpIpTlsUseSecurityExtensionForceMacThenHash, lc-state=draft
      lc-object=TcpIpTlsVersion, lc-state=draft
      lc-object=TcpIpTlsCiphersuiteWorker, lc-state=draft
      lc-object=TcpIpTlsCipherAEADCipherKeyLength, lc-state=draft
      lc-object=TcpIpTlsCipherEncryptKeyLength, lc-state=draft
      lc-object=TcpIpTlsCipherMacKeyLength, lc-state=draft
      lc-object=TcpIpTlsCipherCsmDecryptJobRef, lc-state=draft
      lc-object=TcpIpTlsCipherCsmDecryptKeyRef, lc-state=draft
      lc-object=TcpIpTlsCipherCsmEncryptJobRef, lc-state=draft
      lc-object=TcpIpTlsCipherCsmEncryptKeyRef, lc-state=draft
      lc-object=TcpIpTlsCipherCsmMacGenerateJobRef, lc-state=draft
      lc-object=TcpIpTlsCipherCsmMacGenerateKeyRef, lc-state=draft
      lc-object=TcpIpTlsCipherCsmMacVerifyJobRef, lc-state=draft
      lc-object=TcpIpTlsCipherCsmMacVerifyKeyRef, lc-state=draft
      lc-object=TcpIpTlsCiphersuiteDefinitionRef, lc-state=draft
      lc-object=TcpIpTlsConnectionHandshakeRef, lc-state=draft
      lc-object=TcpIpTlsHandshake, lc-state=draft
      lc-object=TcpIpTlsCsmPRFSupportType, lc-state=draft
      lc-object=TcpIpTlsCsmHashVerifyJobRef, lc-state=draft
      lc-object=TcpIpTlsCsmKeyExchangeCalcPubValJobRef, lc-state=draft
      lc-object=TcpIpTlsCsmKeyExchangeCalcSecretJobRef, lc-state=draft
      lc-object=TcpIpTlsCsmKeyExchangeDecryptJobRef, lc-state=draft
      lc-object=TcpIpTlsCsmKeyExchangeDecryptKeyRef, lc-state=draft
      lc-object=TcpIpTlsCsmKeyExchangeEncryptJobRef, lc-state=draft
      lc-object=TcpIpTlsCsmKeyExchangeEncryptKeyRef, lc-state=draft
      lc-object=TcpIpTlsCsmKeyExchangeKeyRef, lc-state=draft
      lc-object=TcpIpTlsCsmKeyExchangeSignatureGenerateJobRef, lc-state=draft
      lc-object=TcpIpTlsCsmKeyExchangeSignatureGenerateKeyRef, lc-state=draft
      lc-object=TcpIpTlsCsmKeyExchangeSignatureVerifyJobRef, lc-state=draft
      lc-object=TcpIpTlsCsmKeyExchangeSignatureVerifyKeyRef, lc-state=draft
      lc-object=TcpIpTlsCsmMasterSecretKeyRef, lc-state=draft
      lc-object=TcpIpTlsCsmPrfMacJobRef, lc-state=draft
      lc-object=TcpIpTlsCsmPrfMacKeyRef, lc-state=draft
      lc-object=TcpIpTlsPskIdentity, lc-state=draft
      lc-object=TcpIpTlsPresharedKeyIdentity, lc-state=draft
      lc-object=TcpIpTlsPresharedKeyIdentityHint, lc-state=draft
      lc-object=TcpIpTlsPskGetClientKeyIdentityFunc, lc-state=draft
      lc-object=TcpIpTlsPskGetKeyIdentyHintFunc, lc-state=draft
      lc-object=TcpIpTlsPskGetServerKeyIdentityFunc, lc-state=draft
      lc-object=TcpIpTlsPresharedKeyCsmKeyRef, lc-state=draft
      lc-object=TcpIpTlsConnection, lc-state=draft
      lc-object=TcpIpTlsConnectionGetTimeFunc, lc-state=draft
      lc-object=TcpIpTlsConnectionId, lc-state=draft
      lc-object=TcpIpTlsConnectionType, lc-state=draft
      lc-object=TcpIpTlsMaxFragmentLength, lc-state=draft
      lc-object=TcpIpTlsPortAssignment, lc-state=draft
      lc-object=TcpIpTlsUseClientAuthenticationRequest, lc-state=draft
      lc-object=TcpIpTlsUseSecurityExtensionRecordSizeLimit, lc-state=draft
      lc-object=TcpIpTlsCertificateIdentityRef, lc-state=draft
      lc-object=TcpIpTlsConnectionCiphersuiteWorkerRef, lc-state=draft
      lc-object=TcpIpTlsConnectionGroupRef, lc-state=draft
      lc-object=TcpIpTlsConnectionPskIdentityRef, lc-state=draft
      lc-object=TcpIpTlsIpAddressAssignment, lc-state=draft
      lc-object=TcpIpTlsConnectionGroup, lc-state=draft
      lc-object=WEthCtrlEcucPartitionRef, lc-state=draft
      lc-object=WEthEcucPartitionRef, lc-state=draft
      lc-object=WEthTrcvConfigEcucPartitionRef, lc-state=draft
      lc-object=WEthTrcvEcucPartitionRef, lc-state=draft
      lc-object=WdgEcucPartitionRef, lc-state=draft
