AUTOSAR XML (schema 00046)
package /AUTOSAR/EcucDefs
  module definition Eth [0..1]: post-build-variant-support=true, variants link-time/post-build/pre-compile  # Configuration of the Eth (Ethernet Driver) module.
    container EthConfigSet  # This container contains the configuration parameters and sub containers of the AUTOSAR Eth module.
      container EthCtrlConfig [1..*]  # Configuration of the individual controller
        boolean EthCtrlEnableMii: set at pre-compile  # Enables / Disables Media Independent Interface (MII) for transceiver access
        boolean EthCtrlEnableRxInterrupt: set at pre-compile  # Enables / Disables receive interrupt
        boolean EthCtrlEnableTxInterrupt: set at pre-compile  # Enables / Disables transmit interrupt
        enumeration EthCtrlMacLayerSpeed [0..1]: {ETH_MAC_LAYER_SPEED_100M, ETH_MAC_LAYER_SPEED_10G, ETH_MAC_LAYER_SPEED_10M, ETH_MAC_LAYER_SPEED_1G}, scope=ECU, multiplicity set at link in variant link-time+post-build / pre-compile in variant pre-compile, post-build-variant-multiplicity=true, post-build-variant-value=true, set at link in variant link-time+post-build / pre-compile in variant pre-compile  # Defines the baud rate of the MAC layer.
        enumeration EthCtrlMacLayerSubType [0..1]: {REDUCED, REVERSED, SERIAL, STANDARD, UNIVERSAL_SERIAL}, scope=ECU, multiplicity set at link in variant link-time+post-build / pre-compile in variant pre-compile, post-build-variant-multiplicity=true, post-build-variant-value=true, set at link in variant link-time+post-build / pre-compile in variant pre-compile  # Defines the MAC layer subtype of a switch port
        enumeration EthCtrlMacLayerType: {ETH_MAC_LAYER_TYPE_XGMII, ETH_MAC_LAYER_TYPE_XMII, ETH_MAC_LAYER_TYPE_XXGMII}, scope=ECU, post-build-variant-value=true, set at link in variant link-time / post-build in variant post-build / pre-compile in variant pre-compile  # Defines the MAC layer type of the ethernet controller.
        integer EthCtrlIdx: 0..255, scope=ECU, set at pre-compile, symbolic-name-value=true  # Specifies the instance ID of the configured controller.
        string EthCtrlPhyAddress [0..1]: multiplicity set at link in variant link-time / post-build in variant post-build / pre-compile in variant pre-compile, post-build-variant-multiplicity=true, post-build-variant-value=true, set at link in variant link-time / post-build in variant post-build / pre-compile in variant pre-compile, max-length=17, min-length=17  # Specifies the unique 48-bit physical address (MAC address) of the controller in network byte order. | Regular Expression: [0-9a-fA-F]{2}[[:-][0-9a-fA-F]{2}]{5}
        reference EthCtrlEcucPartitionRef [0..1]: scope=ECU, multiplicity set at pre-compile, post-build-variant-multiplicity=true, post-build-variant-value=true, set at pre-compile, destination=EcucPartition  # Maps the Ethernet controller to zero or one ECUC partitions. The ECUC partition referenced is a subset of the ECUC partitions where the Ethernet driver is mapped to. Tags: atp.Status=draft
        reference EthCoreRef: multiplicity set at pre-compile, set at pre-compile, destination=EcucCoreDefinition  # Reference to the Core Definition in the Ecuc Module where the CoreId is defined. This reference is used to describe to which Core the Eth is bound. / 概述：定义Eth模块Controller的所属核，引用EcuM模块的核定义。 注意：单个controller只允许配置在单核。
        container EthCtrlConfigEgress  # Configuration of one Ethernet controler egress behavior.
          reference EthCtrlConfigEgressLastSchedulerRef: set at pre-compile, destination=EthCtrlConfigScheduler  # Reference to the scheduler which is the last in the egress structure.
          container EthCtrlConfigEgressFifo [0..*]: multiplicity set at link in variant link-time / post-build in variant post-build / pre-compile in variant pre-compile, post-build-variant-multiplicity=true  # Represents a Fifo at the egress side.
            integer EthCtrlConfigEgressFifoBufLenByte: 0..65535, post-build-variant-value=true, set at link in variant link-time / post-build in variant post-build / pre-compile in variant pre-compile  # Length of Fifo elements in bytes.
            integer EthCtrlConfigEgressFifoBufTotal: 0..65535, post-build-variant-value=true, set at link in variant link-time / post-build in variant post-build / pre-compile in variant pre-compile  # Fifo buffer count.
            integer EthCtrlConfigEgressFifoIdx: 0..255, post-build-variant-value=true, set at link in variant link-time / post-build in variant post-build / pre-compile in variant pre-compile  # Egress Fifo index.
            integer EthCtrlConfigEgressFifoPriorityAssignment [0..*]: 0..7, multiplicity set at link in variant link-time / post-build in variant post-build / pre-compile in variant pre-compile, post-build-variant-multiplicity=true, post-build-variant-value=true, set at link in variant link-time / post-build in variant post-build / pre-compile in variant pre-compile  # Message egress prority assignment.
          container EthCtrlConfigScheduler [1..*]  # Represents a Scheduler on the egress side.
            container EthCtrlConfigSchedulerPredecessor [1..*]  # Defines an ordered list of predecessors for this scheduler.
              integer EthCtrlConfigSchedulerPredecessorOrder: 0..18446744073709551615, post-build-variant-value=true, set at link in variant link-time / post-build in variant post-build / pre-compile in variant pre-compile  # Defines the order of the scheduler predecessors.
              choice reference EthCtrlConfigSchedulerPredecessorRef: set at pre-compile, destination=[EthCtrlConfigEgressFifo, EthCtrlConfigScheduler, EthCtrlConfigShaper]  # Choice reference to the scheduler predecessor.
          container EthCtrlConfigShaper [0..*]  # Represents a Shaper an the egress side.
            integer EthCtrlConfigShaperIdleSlope [0..1]: 0..18446744073709551615, post-build-variant-value=true, set at link in variant link-time / post-build in variant post-build / pre-compile in variant pre-compile  # Defines the increase of credit in bits per second for the AVB shaper.
            reference EthCtrlConfigShaperPredecessorFifoRef: set at pre-compile, destination=EthCtrlConfigEgressFifo  # Reference to the fifo which is the predecessor for this shaper.
        container EthCtrlConfigIngress  # Configuration of one Ethernet controler ingress behavior.
          container EthCtrlConfigIngressFifo [0..*]: multiplicity set at link in variant link-time / post-build in variant post-build / pre-compile in variant pre-compile, post-build-variant-multiplicity=true  # Represents a Fifo at the ingress side.
            integer EthCtrlConfigIngressFifoBufLenByte: 0..65535, post-build-variant-value=true, set at link in variant link-time / post-build in variant post-build / pre-compile in variant pre-compile  # Length of Fifo elements in bytes.
            integer EthCtrlConfigIngressFifoBufTotal: 0..65535, post-build-variant-value=true, set at link in variant link-time / post-build in variant post-build / pre-compile in variant pre-compile  # Fifo buffer count.
            integer EthCtrlConfigIngressFifoIdx: 0..255, post-build-variant-value=true, set at link in variant link-time / post-build in variant post-build / pre-compile in variant pre-compile, symbolic-name-value=true  # Ingress Fifo index.
            integer EthCtrlConfigIngressFifoPriorityAssignment [0..*]: 0..7, multiplicity set at link in variant link-time / post-build in variant post-build / pre-compile in variant pre-compile, post-build-variant-multiplicity=true, post-build-variant-value=true, set at link in variant link-time / post-build in variant post-build / pre-compile in variant pre-compile  # Message ingress prority assignment.
        container EthDemEventParameterRefs [0..1]  # Container for the references to DemEventParameter elements which shall be invoked using the API Dem_SetEventStatus in case the corresponding error occurs. The EventId is taken from the referenced DemEventParameter's DemEventId symbolic value. The standardized errors are provided in this container and can be extended by vendor-specific error references.
          reference ETH_E_ACCESS [0..1]: multiplicity set at link in variant link-time / post-build in variant post-build / pre-compile in variant pre-compile, post-build-variant-multiplicity=true, post-build-variant-value=true, set at link in variant link-time / post-build in variant post-build / pre-compile in variant pre-compile, requires-symbolic-name-value=true, destination=DemEventParameter  # Reference to the DemEventParameter which shall be issued when the error "Controller access failed" has occured.
          reference ETH_E_ALIGNMENT [0..1]: multiplicity set at link in variant link-time / post-build in variant post-build / pre-compile in variant pre-compile, post-build-variant-multiplicity=true, post-build-variant-value=true, set at link in variant link-time / post-build in variant post-build / pre-compile in variant pre-compile, requires-symbolic-name-value=true, destination=DemEventParameter  # Reference to the DemEventParameter which shall be issued when the error "Alignment Error" has occured.
          reference ETH_E_CRC [0..1]: multiplicity set at link in variant link-time / post-build in variant post-build / pre-compile in variant pre-compile, post-build-variant-multiplicity=true, post-build-variant-value=true, set at link in variant link-time / post-build in variant post-build / pre-compile in variant pre-compile, requires-symbolic-name-value=true, destination=DemEventParameter  # Reference to the DemEventParameter which shall be issued when the error "CRC Failure" has occured.
          reference ETH_E_LATECOLLISION [0..1]: multiplicity set at link in variant link-time / post-build in variant post-build / pre-compile in variant pre-compile, post-build-variant-multiplicity=true, post-build-variant-value=true, set at link in variant link-time / post-build in variant post-build / pre-compile in variant pre-compile, requires-symbolic-name-value=true, destination=DemEventParameter  # Reference to the DemEventParameter which shall be issued when the error "Late Collisions" has occured.
          reference ETH_E_MULTIPLECOLLISION [0..1]: multiplicity set at link in variant link-time / post-build in variant post-build / pre-compile in variant pre-compile, post-build-variant-multiplicity=true, post-build-variant-value=true, set at link in variant link-time / post-build in variant post-build / pre-compile in variant pre-compile, requires-symbolic-name-value=true, destination=DemEventParameter  # Reference to the DemEventParameter which shall be issued when the error "Multiple Collisions" has occured.
          reference ETH_E_OVERSIZEFRAME [0..1]: multiplicity set at link in variant link-time / post-build in variant post-build / pre-compile in variant pre-compile, post-build-variant-multiplicity=true, post-build-variant-value=true, set at link in variant link-time / post-build in variant post-build / pre-compile in variant pre-compile, requires-symbolic-name-value=true, destination=DemEventParameter  # Reference to the DemEventParameter which shall be issued when the error "Oversized Frame" has occured.
          reference ETH_E_RX_FRAMES_LOST [0..1]: multiplicity set at link in variant link-time / post-build in variant post-build / pre-compile in variant pre-compile, post-build-variant-multiplicity=true, post-build-variant-value=true, set at link in variant link-time / post-build in variant post-build / pre-compile in variant pre-compile, requires-symbolic-name-value=true, destination=DemEventParameter  # Reference to the DemEventParameter which shall be issued when the error "receive frames lost" has occured.
          reference ETH_E_SINGLECOLLISION [0..1]: multiplicity set at link in variant link-time / post-build in variant post-build / pre-compile in variant pre-compile, post-build-variant-multiplicity=true, post-build-variant-value=true, set at link in variant link-time / post-build in variant post-build / pre-compile in variant pre-compile, requires-symbolic-name-value=true, destination=DemEventParameter  # Reference to the DemEventParameter which shall be issued when the error "Single Collisions" has occured.
          reference ETH_E_UNDERSIZEFRAME [0..1]: multiplicity set at link in variant link-time / post-build in variant post-build / pre-compile in variant pre-compile, post-build-variant-multiplicity=true, post-build-variant-value=true, set at link in variant link-time / post-build in variant post-build / pre-compile in variant pre-compile, requires-symbolic-name-value=true, destination=DemEventParameter  # Reference to the DemEventParameter which shall be issued when the error "Undersized Frame" has occured.
    container EthGeneral  # General configuration of Ethernet Driver module
      boolean EthDevErrorDetect: set at pre-compile, default-value=false  # Switches the development error detection and notification on or off. | * true: detection and notification is enabled. * false: detection and notification is disabled.
      boolean EthGetDropCountApi: set at pre-compile  # Enables / Disables Eth_GetCounterValues API.
      boolean EthGetEtherStatsApi: set at pre-compile  # Enables / Disables Eth_GetEtherStats API.
      boolean EthGetTxErrorCounterValuesApi: set at pre-compile, default-value=false  # Enables/Disables Eth_GetTxErrorCounterValues API.
      boolean EthGetTxStatsApi: set at pre-compile, default-value=false  # Enables/Disables Eth_GetTxStats API.
      boolean EthGlobalTimeSupport: set at pre-compile  # Enables/Disables the GlobalTime APIs used amongst others by Global Time Synchronization over Ethernet.
      boolean EthVersionInfoApi: set at pre-compile, default-value=false  # Enables / Disables version info API
      float EthMainFunctionPeriod: 0..Inf, set at pre-compile  # Specifies the period of main function Eth_MainFunction in seconds. Ethernet driver does not require this information but the BSW scheduler.
      integer EthIndex: 0..255, set at pre-compile  # Specifies the InstanceId of this module instance. If only one instance is present it shall have the Id 0.
      integer EthMaxCtrlsSupported: 1..255, set at pre-compile  # Limits the total number of supported controllers.
      reference EthEcucPartitionRef [0..*]: scope=ECU, multiplicity set at pre-compile, post-build-variant-multiplicity=true, post-build-variant-value=true, set at pre-compile, destination=EcucPartition  # Maps the Ethernet driver to zero or multiple ECUC partitions to make the modules API available in this partition. The Ethernet driver will operate as an independent instance in each of the partitions. Tags: atp.Status=draft
      container EthCtrlOffloading  # Configuration of hardware offloading features.
        boolean EthCtrlEnableOffloadChecksumICMP: set at pre-compile  # Enables / Disables hardware offloading for ICMP checksums.
        boolean EthCtrlEnableOffloadChecksumIPv4: set at pre-compile  # Enables / Disables hardware offloading for IPv4 checksums.
        boolean EthCtrlEnableOffloadChecksumTCP: set at pre-compile  # Enables / Disables hardware offloading for TCP checksums.
        boolean EthCtrlEnableOffloadChecksumUDP: set at pre-compile  # Enables / Disables hardware offloading for UDP checksums.
package /AUTOSAR/EcucDestinationUriDefSets
  ecuc destination uri def set RteRipsUriDefSet
    ecuc destination uri def RteRipsInvocationHandler
      destination-uri-policy destination-uri-nesting-contract=TARGET-CONTAINER:
        container RteRipsInvocationHandlerFnc [0..*]  # This container describes an invocation handler function implemented by an RTE Implementation Plug-In to handle the invocation of server runnables and triggered runnables via a transformer. Tags: atp.Status=draft
          function name RteRipsInvocationHandlerFncSymbol  # C-Symbol of the Rte_Rips_FillFlushRoutine function. Tags: atp.Status=draft
    ecuc destination uri def RteRipsPlugin
      destination-uri-policy destination-uri-nesting-contract=TARGET-CONTAINER:
        container RteRipsPluginProps  # This container defines the identity of the Rte Implementation Plug-in and provides the RTE relevant parameters of the Rte Implementation Plug-in. Tags: atp.Status=draft | The shortName of the container defines the name of the Rte Implementation Plug-in used for the API infixes.
          boolean RtePluginSupportsIReadIWrite: default-value=false  # Denotes if or if not the plug-in supports the Rte_Rips_IRead/IWrite macros for primitive data. Tags: atp.Status=draft
          enumeration RteRipsGlobalCopyInstantiationPolicy: {RTE_RIPS_INSTANTIATION_BY_PLUGIN, RTE_RIPS_INSTANTIATION_BY_RTE}, default-value=RTE_RIPS_INSTANTIATION_BY_RTE  # Globally enables or disables the support for Rte Implementation Plug-Ins (RIPS) Tags: atp.Status=draft
    ecuc destination uri def RteRipsPluginFillFlushRoutine
      destination-uri-policy destination-uri-nesting-contract=TARGET-CONTAINER:
        container RteRipsPluginFillFlushRoutineFnc [0..*]  # This container describes a Fill-Flush Routine function implemented by a RTE Implementation Plug-In to handle the buffering for implicit communication. Tags: atp.Status=draft
          enumeration RteRipsModeDisablingHandling: {RTE_RIPS_CONSIDER_MODE_DISABLINGS, RTE_RIPS_IGNORE_MODE_DISABLINGS}  # This parameter configures whether mode disabling dependencies are considered for the invocation of Rte_Rips_FillFlushRoutines. Tags: atp.Status=draft
          enumeration RteRipsOsSchedulePoint [0..1]: {NONE, UNCONDITIONAL}  # Introduce a schedule point by explicitly calling Os Schedule service after the execution of the Rte_Rips_FillFlushRoutine. Tags: atp.Status=draft
          function name RteRipsPluginFillFlushRoutineFncSymbol  # C-Symbol of the Rte_Rips_FillFlushRoutine function. Tags: atp.Status=draft
package /AUTOSAR/LifeCycleInfoSets
  life cycle info set AUTOSARParameterDefinition
    life-cycle-infos:
      lc-object=AdcGroupEcucPartitionRef, lc-state=draft
      lc-object=AdcEcucPartitionRef, lc-state=draft
      lc-object=AdcKernelEcucPartitionRef, lc-state=draft
      lc-object=ArtiConstant, lc-state=draft
      lc-object=ArtiConstantString, lc-state=draft
      lc-object=ArtiExpression, lc-state=draft
      lc-object=ArtiExpressionString, lc-state=draft
      lc-object=ArtiHook, lc-state=draft
      lc-object=ArtiHookClass, lc-state=draft
      lc-object=ArtiHookEventName, lc-state=draft
      lc-object=ArtiHookInstance, lc-state=draft
      lc-object=ArtiHookEventParameterTypeRef, lc-state=draft
      lc-object=ArtiHookInstanceParameterTypeRef, lc-state=draft
      lc-object=ArtiObjectClassParameter, lc-state=draft
      lc-object=ArtiParameterTypeMapRef, lc-state=draft
      lc-object=ArtiObjectInstanceParameter, lc-state=draft
      lc-object=ArtiConstantRef, lc-state=draft
      lc-object=ArtiExpressionRef, lc-state=draft
      lc-object=ArtiHookRef, lc-state=draft
      lc-object=ArtiParameterTypeMap, lc-state=draft
      lc-object=ArtiParameterTypeMapPair, lc-state=draft
      lc-object=ArtiParameterTypeMapPairInput, lc-state=draft
      lc-object=ArtiParameterTypeMapPairOutput, lc-state=draft
      lc-object=ArtiGenericComponentClass, lc-state=draft
      lc-object=ArtiGenericComponentClassName, lc-state=draft
      lc-object=ArtiGenericComponentClassParameter, lc-state=draft
      lc-object=ArtiGenericComponentClassParameterName, lc-state=draft
      lc-object=ArtiParameterTypeMapRef, lc-state=draft
      lc-object=ArtiGenericComponentInstance, lc-state=draft
      lc-object=ArtiGenericComponentInstanceName, lc-state=draft
      lc-object=ArtiGenericComponentClassRef, lc-state=draft
      lc-object=ArtiGenericComponentInstanceParameter, lc-state=draft
      lc-object=ArtiConstantRef, lc-state=draft
      lc-object=ArtiExpressionRef, lc-state=draft
      lc-object=ArtiGenericComponentClassParameterRef, lc-state=draft
      lc-object=ArtiHookRef, lc-state=draft
      lc-object=ArtiHwCoreClass, lc-state=draft
      lc-object=ArtiCurrentApplicationClassRef, lc-state=draft
      lc-object=ArtiCurrentTaskClassRef, lc-state=draft
      lc-object=ArtiLastErrorClassRef, lc-state=draft
      lc-object=ArtiHwCoreInstance, lc-state=draft
      lc-object=ArtiCurrentApplicationInstanceRef, lc-state=draft
      lc-object=ArtiCurrentTaskInstanceRef, lc-state=draft
      lc-object=ArtiEcucCoreRef, lc-state=draft
      lc-object=ArtiLastErrorInstanceRef, lc-state=draft
      lc-object=ArtiOsClass, lc-state=draft
      lc-object=ArtiOsAppModeClassRef, lc-state=draft
      lc-object=ArtiOsInstance, lc-state=draft
      lc-object=ArtiOsAppModeEcucRef, lc-state=draft
      lc-object=ArtiOsAppModeInstanceRef, lc-state=draft
      lc-object=ArtiOsEcucRef, lc-state=draft
      lc-object=ArtiOsTaskHookRef, lc-state=draft
      lc-object=ArtiOsTaskClass, lc-state=draft
      lc-object=ArtiOsTaskInstance, lc-state=draft
      lc-object=ArtiGenericComponentInstanceRef, lc-state=draft
      lc-object=ArtiOsTaskEcucRef, lc-state=draft
      lc-object=CanControllerEcucPartitionRef, lc-state=draft
      lc-object=CanTTControllerEcucPartitionRef, lc-state=draft
      lc-object=CanEcucPartitionRef, lc-state=draft
      lc-object=CanTSynGlobalTimeSecureTmacLength, lc-state=draft
      lc-object=CanTSynTxTmacCalculated, lc-state=draft
      lc-object=CanTSynGlobalTimeMinMsgGap, lc-state=draft
      lc-object=CanTSynRxTmacValidated, lc-state=draft
      lc-object=CanTrcvChannelEcucPartitionRef, lc-state=draft
      lc-object=CanTrcvEcucPartitionRef, lc-state=draft
      lc-object=CorTstBackgroundEcucPartitionRef, lc-state=draft
      lc-object=CorTstForegroundEcucPartitionRef, lc-state=draft
      lc-object=CorTstEcucPartitionRef, lc-state=draft
      lc-object=CryptoDriverObjectEcucPartitionRef, lc-state=draft
      lc-object=CryptoEcucPartitionRef, lc-state=draft
      lc-object=DemFreezeFrameRecordTrigger, lc-state=draft
      lc-object=DioPortEcucPartitionRef, lc-state=draft
      lc-object=DioChannelEcucPartitionRef, lc-state=draft
      lc-object=DioChannelGroupEcucPartitionRef, lc-state=draft
      lc-object=DioEcucPartitionRef, lc-state=draft
      lc-object=EepEcucPartitionRef, lc-state=draft
      lc-object=EthCtrlEcucPartitionRef, lc-state=draft
      lc-object=EthEcucPartitionRef, lc-state=draft
      lc-object=EthSwtConfigEcucPartitionRef, lc-state=draft
      lc-object=EthSwtEcucPartitionRef, lc-state=draft
      lc-object=EthTSynGlobalTimeSecureTmacLength, lc-state=draft
      lc-object=EthTSynGlobalTimeMinMsgGap, lc-state=draft
      lc-object=EthTSynTxTmacCalculated, lc-state=draft
      lc-object=EthTSynRxTmacValidated, lc-state=draft
      lc-object=EthTrcvConfigEcucPartitionRef, lc-state=draft
      lc-object=EthTrcvEcucPartitionRef, lc-state=draft
      lc-object=FlsEcucPartitionRef, lc-state=draft
      lc-object=FlsTstEcucPartitionRef, lc-state=draft
      lc-object=FrEcucPartitionRef, lc-state=draft
      lc-object=FrCtrlEcucPartitionRef, lc-state=draft
      lc-object=FrTSynGlobalTimeSecureTmacLength, lc-state=draft
      lc-object=FrTSynUseExtendedMsgFormat, lc-state=draft
      lc-object=FrTSynTxTmacCalculated, lc-state=draft
      lc-object=FrTSynGlobalTimeMinMsgGap, lc-state=draft
      lc-object=FrTSynGlobalTimeTmacTimeout, lc-state=draft
      lc-object=FrTSynRxTmacValidated, lc-state=draft
      lc-object=FrTrcvChannelEcucPartitionRef, lc-state=draft
      lc-object=FrTrcvEcucPartitionRef, lc-state=draft
      lc-object=GptChannelEcucPartitionRef, lc-state=draft
      lc-object=GptEcucPartitionRef, lc-state=draft
      lc-object=GptKernelEcucPartitionRef, lc-state=draft
      lc-object=IcuChannelEcucPartitionRef, lc-state=draft
      lc-object=IcuEcucPartitionRef, lc-state=draft
      lc-object=IcuKernelEcucPartitionRef, lc-state=draft
      lc-object=IpduMContainedPduOffset, lc-state=draft
      lc-object=IpduMPduUpdateBitPosition, lc-state=draft
      lc-object=IpduMContainedPduOffset, lc-state=draft
      lc-object=IpduMPduUpdateBitPosition, lc-state=draft
      lc-object=IPDUM_HEADERTYPE_NONE, lc-state=draft
      lc-object=IPDUM_HEADERTYPE_NONE, lc-state=draft
      lc-object=IpduMUnusedAreasDefault, lc-state=draft
      lc-object=LinEcucPartitionRef, lc-state=draft
      lc-object=LinChannelEcucPartitionRef, lc-state=draft
      lc-object=LinTrcvChannelEcucPartitionRef, lc-state=draft
      lc-object=LinTrcvEcucPartitionRef, lc-state=draft
      lc-object=McuEcucPartitionRef, lc-state=draft
      lc-object=OcuChannelEcucPartitionRef, lc-state=draft
      lc-object=OcuEcucPartitionRef, lc-state=draft
      lc-object=OcuKernelEcucPartitionRef, lc-state=draft
      lc-object=PortPinEcucPartitionRef, lc-state=draft
      lc-object=PortEcucPartitionRef, lc-state=draft
      lc-object=PwmChannelEcucPartitionRef, lc-state=draft
      lc-object=PwmEcucPartitionRef, lc-state=draft
      lc-object=PwmKernelEcucPartitionRef, lc-state=draft
      lc-object=RamTstEcucPartitionRef, lc-state=draft
      lc-object=RamTstBlockParamsEcucPartitionRef, lc-state=draft
      lc-object=RteRipsFillRoutineRef, lc-state=draft
      lc-object=RteRipsFlushRoutineRef, lc-state=draft
      lc-object=RteBswExclusiveAreaResponsibleRipsPluginRef, lc-state=draft
      lc-object=RteModeMachineInstanceResponsibleRipsPluginRef, lc-state=draft
      lc-object=RteDSMQResponsibleRipsPluginRef, lc-state=draft
      lc-object=RteRips, lc-state=draft
      lc-object=RteRipsSupport, lc-state=draft
      lc-object=RteRipsPluginConfigurationRef, lc-state=draft
      lc-object=RteRipsFillRoutineRef, lc-state=draft
      lc-object=RteRipsFlushRoutineRef, lc-state=draft
      lc-object=RteRipsInvocationHandlerRef, lc-state=draft
      lc-object=RteExclusiveAreaResponsibleRipsPluginRef, lc-state=draft
      lc-object=RteModeMachineInstanceResponsibleRipsPluginRef, lc-state=draft
      lc-object=SoAdSocketTcpTlsConnectionRef, lc-state=draft
      lc-object=SpiDeviceEcucPartitionRef, lc-state=draft
      lc-object=SpiEcucPartitionRef, lc-state=draft
      lc-object=SpiKernelEcucPartitionRef, lc-state=draft
      lc-object=TcpIpTlsConfig, lc-state=draft
      lc-object=TcpIpTlsMaxConnections, lc-state=draft
      lc-object=TcpIpTlsCsmRandomGenerateJobRef, lc-state=draft
      lc-object=TcpIpTlsCiphersuites, lc-state=draft
      lc-object=TcpIpTlsCertificateIdentity, lc-state=draft
      lc-object=TcpIpTlsServerNameIdentification, lc-state=draft
      lc-object=TcpIpTlsCiphersuiteDefinition, lc-state=draft
      lc-object=TcpIpTlsCiphersuiteId, lc-state=draft
      lc-object=TcpIpTlsCiphersuiteName, lc-state=draft
      lc-object=TcpIpTlsCiphersuitePriority, lc-state=draft
      lc-object=TcpIpTlsUseAEADCipher, lc-state=draft
      lc-object=TcpIpTlsUsePresharedKeys, lc-state=draft
      lc-object=TcpIpTlsUseSecurityExtensionForceMacThenHash, lc-state=draft
      lc-object=TcpIpTlsVersion, lc-state=draft
      lc-object=TcpIpTlsCiphersuiteWorker, lc-state=draft
      lc-object=TcpIpTlsCipherAEADCipherKeyLength, lc-state=draft
      lc-object=TcpIpTlsCipherEncryptKeyLength, lc-state=draft
      lc-object=TcpIpTlsCipherMacKeyLength, lc-state=draft
      lc-object=TcpIpTlsCipherCsmDecryptJobRef, lc-state=draft
      lc-object=TcpIpTlsCipherCsmDecryptKeyRef, lc-state=draft
      lc-object=TcpIpTlsCipherCsmEncryptJobRef, lc-state=draft
      lc-object=TcpIpTlsCipherCsmEncryptKeyRef, lc-state=draft
      lc-object=TcpIpTlsCipherCsmMacGenerateJobRef, lc-state=draft
      lc-object=TcpIpTlsCipherCsmMacGenerateKeyRef, lc-state=draft
      lc-object=TcpIpTlsCipherCsmMacVerifyJobRef, lc-state=draft
      lc-object=TcpIpTlsCipherCsmMacVerifyKeyRef, lc-state=draft
      lc-object=TcpIpTlsCiphersuiteDefinitionRef, lc-state=draft
      lc-object=TcpIpTlsConnectionHandshakeRef, lc-state=draft
      lc-object=TcpIpTlsHandshake, lc-state=draft
      lc-object=TcpIpTlsCsmPRFSupportType, lc-state=draft
      lc-object=TcpIpTlsCsmHashVerifyJobRef, lc-state=draft
      lc-object=TcpIpTlsCsmKeyExchangeCalcPubValJobRef, lc-state=draft
      lc-object=TcpIpTlsCsmKeyExchangeCalcSecretJobRef, lc-state=draft
      lc-object=TcpIpTlsCsmKeyExchangeDecryptJobRef, lc-state=draft
      lc-object=TcpIpTlsCsmKeyExchangeDecryptKeyRef, lc-state=draft
      lc-object=TcpIpTlsCsmKeyExchangeEncryptJobRef, lc-state=draft
      lc-object=TcpIpTlsCsmKeyExchangeEncryptKeyRef, lc-state=draft
      lc-object=TcpIpTlsCsmKeyExchangeKeyRef, lc-state=draft
      lc-object=TcpIpTlsCsmKeyExchangeSignatureGenerateJobRef, lc-state=draft
      lc-object=TcpIpTlsCsmKeyExchangeSignatureGenerateKeyRef, lc-state=draft
      lc-object=TcpIpTlsCsmKeyExchangeSignatureVerifyJobRef, lc-state=draft
      lc-object=TcpIpTlsCsmKeyExchangeSignatureVerifyKeyRef, lc-state=draft
      lc-object=TcpIpTlsCsmMasterSecretKeyRef, lc-state=draft
      lc-object=TcpIpTlsCsmPrfMacJobRef, lc-state=draft
      lc-object=TcpIpTlsCsmPrfMacKeyRef, lc-state=draft
      lc-object=TcpIpTlsPskIdentity, lc-state=draft
      lc-object=TcpIpTlsPresharedKeyIdentity, lc-state=draft
      lc-object=TcpIpTlsPresharedKeyIdentityHint, lc-state=draft
      lc-object=TcpIpTlsPskGetClientKeyIdentityFunc, lc-state=draft
      lc-object=TcpIpTlsPskGetKeyIdentyHintFunc, lc-state=draft
      lc-object=TcpIpTlsPskGetServerKeyIdentityFunc, lc-state=draft
      lc-object=TcpIpTlsPresharedKeyCsmKeyRef, lc-state=draft
      lc-object=TcpIpTlsConnection, lc-state=draft
      lc-object=TcpIpTlsConnectionGetTimeFunc, lc-state=draft
      lc-object=TcpIpTlsConnectionId, lc-state=draft
      lc-object=TcpIpTlsConnectionType, lc-state=draft
      lc-object=TcpIpTlsMaxFragmentLength, lc-state=draft
      lc-object=TcpIpTlsPortAssignment, lc-state=draft
      lc-object=TcpIpTlsUseClientAuthenticationRequest, lc-state=draft
      lc-object=TcpIpTlsUseSecurityExtensionRecordSizeLimit, lc-state=draft
      lc-object=TcpIpTlsCertificateIdentityRef, lc-state=draft
      lc-object=TcpIpTlsConnectionCiphersuiteWorkerRef, lc-state=draft
      lc-object=TcpIpTlsConnectionGroupRef, lc-state=draft
      lc-object=TcpIpTlsConnectionPskIdentityRef, lc-state=draft
      lc-object=TcpIpTlsIpAddressAssignment, lc-state=draft
      lc-object=TcpIpTlsConnectionGroup, lc-state=draft
      lc-object=WEthCtrlEcucPartitionRef, lc-state=draft
      lc-object=WEthEcucPartitionRef, lc-state=draft
      lc-object=WEthTrcvConfigEcucPartitionRef, lc-state=draft
      lc-object=WEthTrcvEcucPartitionRef, lc-state=draft
      lc-object=WdgEcucPartitionRef, lc-state=draft
