AUTOSAR XML (schema 00046)
package /AUTOSAR/EcucDefs
  module definition Rte [0..1]: post-build-variant-support=true, variants post-build/pre-compile  # Configuration of the Rte (Runtime Environment) module.
    container RteBswGeneral  # General configuration parameters of the Bsw Scheduler section.
      boolean RteSchMVersionInfoApi: set at pre-compile, default-value=false  # Enables the generation of the SchM_GetVersionInfo() API.
    container RteBswModuleInstance [0..*]  # Represents one instance of a Bsw-Module configured on one ECU.
      foreign reference RteBswImplementationRef [0..1]: set at pre-compile, destination-type=BSW-IMPLEMENTATION  # Reference to the BswImplementation for which the Rte /SchM is configured.
      foreign reference RteBswModuleConfigurationRef [0..1]: multiplicity set at pre-compile, set at pre-compile, destination-type=ECUC-MODULE-CONFIGURATION-VALUES  # Reference to the ECU Configuration Values provided for this BswImplementation.
      container RteBswEventToTaskMapping [0..*]  # Maps a BswModuleEntity onto an OsTask based on the activating BswEvent. A BswModuleEntity can be activated by more than one BswEvent and thus be mapped to more than one OsTask. In the case of a BswSchedulableEntity executed via a direct function call this RteBswEventToTaskMapping is still specified but no RteBswMappedToTaskRef element is included. The RteBswPositionInTask parameter is necessary to provide an ordering of events invoked by the same RTE API.
        boolean RteBswImmediateRestart: set at pre-compile, default-value=false  # When RteBswImmediateRestart is set to true the BswSchedulableEntitiy shall be immediately re-started after termination if it was activated by this BswEvent while it was already started. | This parameter shall not be set to true when the mapped BswEvent refers to a BswSchedulableEntitiy which minimumStartInterval attribute is > 0.
        enumeration RteOsSchedulePoint [0..1]: {CONDITIONAL, NONE, UNCONDITIONAL}, multiplicity set at pre-compile, set at pre-compile  # Introduce a schedule point by explicitly calling Os Schedule service after the execution of the ExecutableEntity. The Rte generator is allowed to optimize several consecutive calls to Os schedule into one single call if the ExecutableEntity executions in between have been skipped. | The absence of this parameter is interpreted as "NONE". It shall be considered an invalid configuration if the task is preemptable and the value of this parameter is not set to "NONE" or the parameter is absent.
        float RteBswActivationOffset [0..1]: 0..Inf, multiplicity set at pre-compile, set at pre-compile  # Activation offset in milliseconds.
        integer RteBswPositionInTask [0..1]: 0..65535, multiplicity set at pre-compile, set at pre-compile  # Each BswSchedulableEntity activation mapped to an OsTask has a specific position within the task execution. | For periodic activation this is the order of execution. For event driver activation this is the order of evaluation which actual BswSchedulableEntity has to be executed. In case of direct function calls this parameter is necessary to provide an ordering of events when several ExecutableEntities are invoked by the same RTE API.
        integer RteBswServerQueueLength [0..1]: 0..65535, multiplicity set at pre-compile, set at pre-compile  # Specifies the length of the queue for the server call serialization.
        foreign reference RteBswEventRef [1..*]: set at pre-compile, destination-type=BSW-EVENT  # Reference to the BswEvent.
        reference RteBswEventPredecessorSyncPointRef [0..1]: multiplicity set at pre-compile, set at pre-compile, destination=RteSyncPoint  # The RteBswEventPredecessorSyncPointRef is necessary to provide a cross core synchronization in case of BswEvents triggered by the same event source but mapped to tasks belonging to different partitions on different cores. | The synchronization point must be reached by all referencing BswEvents before the execution in all related tasks is continued. In case of RteBswEventPredecessorSyncPointRef the BswModuleEntity activated by the mapped BswEvent is executed after the synchronization point is passed.
        reference RteBswEventSuccessorSyncPointRef [0..1]: multiplicity set at pre-compile, set at pre-compile, destination=RteSyncPoint  # The RteBswEventSuccessorSyncPointRef is necessary to provide a cross core synchronization in case of BswEvents triggered by the same event source but mapped to tasks belonging to different partitions on different cores. | The synchronization point must be reached by all referencing BswEvents before the execution in all related tasks is continued. In case of RteBswEventSuccessorSyncPointRef the BswModuleEntity activated by the mapped BswEvent is executed before the synchronization point is entered.
        reference RteBswMappedToTaskRef [0..1]: multiplicity set at pre-compile, set at pre-compile, destination=OsTask  # Reference to the OsTask the BswSchedulableEntity activated by the RteBswEventRef is mapped to. | If no reference to the OsTask is specified the BswSchedulableEntity activated by this BswEvent is executed in the context of the caller.
        reference RteBswUsedOsAlarmRef [0..1]: multiplicity set at pre-compile, set at pre-compile, destination=OsAlarm  # If an OsAlarm is used to activate the OsTask this BswEvent is mapped to it shall be referenced here.
        reference RteBswUsedOsEventRef [0..1]: multiplicity set at pre-compile, set at pre-compile, destination=OsEvent  # If an OsEvent is used to activate the OsTask this BswEvent is mapped to it shall be referenced here.
        reference RteBswUsedOsSchTblExpiryPointRef [0..1]: multiplicity set at pre-compile, set at pre-compile, destination=OsScheduleTableExpiryPoint  # If an OsScheduleTableExpiryPoint is used to activate the OsTask this BswEvent is mapped to it shall be referenced here.
        uri reference RteRipsFillRoutineRef [0..*]: multiplicity set at pre-compile, requires-index=true, set at pre-compile, destination-uri=RteRipsPluginFillFlushRoutine  # Reference to a Buffer-Fill Routine implemented by an RTE Implementation Plug-In. Tags: atp.Status=draft | This routine gets invoked directly before the ExecutableEntity is started.
        uri reference RteRipsFlushRoutineRef [0..*]: multiplicity set at pre-compile, requires-index=true, set at pre-compile, destination-uri=RteRipsPluginFillFlushRoutine  # Reference to a Buffer-Flush Routine implemented by an RTE Implementation Plug-In. Tags: atp.Status=draft | This routine gets invoked directly after the ExecutableEntity has terminated.
      container RteBswExclusiveAreaImpl [0..*]  # Represents one ExclusiveArea of one BswImplementation. Used to specify the implementation means of this ExclusiveArea.
        enumeration RteExclusiveAreaImplMechanism: {ALL_INTERRUPT_BLOCKING, NONE, OS_INTERRUPT_BLOCKING, OS_RESOURCE, OS_SPINLOCK, RTE_PLUGIN}, set at pre-compile  # To be used implementation mechanism for the specified ExclusiveArea.
        foreign reference RteBswExclusiveAreaRef: set at pre-compile, destination-type=EXCLUSIVE-AREA  # Reference to the ExclusiveArea for which the implementation mechanism shall be specified.
        reference RteBswExclusiveAreaOsResourceRef [0..1]: multiplicity set at pre-compile, set at pre-compile, destination=OsResource  # Optional reference to an OsResource in case RteExclusiveAreaImplMechanism is configured to OS_RESOURCE for this ExclusiveArea.
        reference RteBswExclusiveAreaOsSpinlockRef [0..1]: multiplicity set at pre-compile, set at pre-compile, destination=OsSpinlock  # Optional reference to an OsSpinlock in case RteExclusiveAreaImplMechanism is configured to OS_SPINLOCK for this ExclusiveArea.
        uri reference RteBswExclusiveAreaResponsibleRipsPluginRef [0..1]: multiplicity set at pre-compile, set at pre-compile, destination-uri=RteRipsPlugin  # Optional reference to the configuration container of the RTE Implementation Plug-in implementing the ExclusiveArea. Tags: atp.Status=draft | It's required in case RteExclusiveAreaImplMechanism is configured to RTE_PLUGIN for this ExclusiveArea.
      container RteBswExternalTriggerConfig [0..*]  # Defines the configuration of Inter Basic Software Module Entity Triggering
        integer RteBswTriggerSourceQueueLength: 0..4294967295, set at pre-compile, default-value=0  # Length of trigger queue on the trigger source side. | The queue is implemented by the RTE. A value greater or equal to 1 requests an queued behavior. Setting the value of RteTriggerSourceQueueLength to 0 requests an none queued implementation of the trigger communication. If there is no RteBswTriggerSourceQueueLength configured for a Trigger Emitter the default value of 0 applies as well.
        foreign reference RteBswTriggerSourceRef: set at pre-compile, destination-type=TRIGGER  # Reference to a Trigger instance in the role releasedTrigger of the related BSW Module instance. | The referenced Trigger has to belong to the same BSW Module instance as the RteBswModuleInstance owning this parameter configures.
      container RteBswInternalTriggerConfig [0..*]  # Defines the configuration of internal Basic Software Module Entity Triggering
        integer RteBswTriggerSourceQueueLength: 0..4294967295, set at pre-compile, default-value=0  # Length of trigger queue on the trigger source side. | The queue is implemented by the RTE. A value greater or equal to 1 requests an queued behavior. Setting the value of RteTriggerSourceQueueLength to 0 requests an none queued implementation of the trigger communication. If there is no RteBswTriggerSourceQueueLength configured for a Trigger Emitter the default value of 0 applies as well.
        foreign reference RteBswTriggerSourceRef: set at pre-compile, destination-type=BSW-INTERNAL-TRIGGERING-POINT  # Reference to a BswInternalTriggeringPoint of the related BSW Module instance. | The referenced BswInternalTriggeringPoint has to belong to the same BSW Module instance as the RteBswModuleInstance owning this parameter configures.
      container RteBswModeMachineInstanceConfig [0..*]  # Defines the configuration of Basic Software Scheduler assigned ( SWS_Rte_07534) mode machine instances.
        integer RteBswModeMachineQueueLength: 0..4294967295, set at pre-compile, default-value=1  # Length of mode machine instance queue on the trigger source side. | If there is no RteBswModeMachineQueueLength configured for a mode machine instance the value given in the BswModeSenderPolicy.queueLength applies.
        foreign reference RteBswModeManagerRef: set at pre-compile, destination-type=MODE-DECLARATION-GROUP-PROTOTYPE  # Reference to a ModeDeclarationGroupPrototype of the related BSW Module instance. | The referenced ModeDeclarationGroupPrototype has to belong to the same BSW Module instance as the RteBswModuleInstance owning this parameter configures.
        uri reference RteModeMachineInstanceResponsibleRipsPluginRef [0..1]: multiplicity set at pre-compile, set at pre-compile, destination-uri=RteRipsPlugin  # Optional reference to the configuration container of the RTE Implementation Plug-in implementing the protection of the mode machine instance. Tags: atp.Status=draft
      container RteBswRequiredClientServerConnection [0..*]  # Defines the connection between one requiredClientServerEntry and one providedClientServerEntry of a BswModuleDescription. This container shall be provided on the client side of the connection.
        foreign reference RteBswProvidedClientServerEntryRef: set at pre-compile, destination-type=BSW-MODULE-CLIENT-SERVER-ENTRY  # Reference the providedClientServerEntry for this connection.
        foreign reference RteBswRequiredClientServerEntryRef: set at pre-compile, destination-type=BSW-MODULE-CLIENT-SERVER-ENTRY  # Reference the requiredClientServerEntry for this connection.
        reference RteBswProvidedClientServerEntryModInstRef: set at pre-compile, destination=RteBswModuleInstance  # Reference to the RteBswModuleInstance configuration container which identifies the instance of the BSW Module. | Used with the RteBswProvidedClientServerEntryRef to unambiguously identify the BswModuleClientServerEntry instance.
      container RteBswRequiredModeGroupConnection [0..*]  # Defines the connection between one requiredModeGroup of this BSW Module instance and one providedModeGroup instance.
        foreign reference RteBswProvidedModeGroupRef: set at pre-compile, destination-type=MODE-DECLARATION-GROUP-PROTOTYPE  # References the providedModeGroupPrototype to which this requiredModeGroup shall be connected.
        foreign reference RteBswRequiredModeGroupRef: set at pre-compile, destination-type=MODE-DECLARATION-GROUP-PROTOTYPE  # References requiredModeGroupPrototype which shall be connected to the providedModeGroupPrototype.
        foreign reference RteModeDeclarationMappingSetRef [0..1]: multiplicity set at pre-compile, set at pre-compile, destination-type=MODE-DECLARATION-MAPPING-SET  # This defines the effective ModeDeclarationMappingSet in the case that the provided ModeDeclarationGroupPrototype and the required ModeDeclarationGroupPrototype are not compatible.
        reference RteBswProvidedModeGrpModInstRef: set at pre-compile, destination=RteBswModuleInstance  # Reference to the RteBswModuleInstance configuration container which identifies the instance of the BSW Module. | Used with the RteBswProvidedModeGroupRef to unambiguously identify the ModeDeclarationGroupPrototype instance.
      container RteBswRequiredSenderReceiverConnection [0..*]  # Defines the connection between one requiredData and one providedData of a BswModuleDescription. This container shall be provided on the receiver side of the connection.
        foreign reference RteBswProvidedVariableDataPrototypeRef: set at pre-compile, destination-type=VARIABLE-DATA-PROTOTYPE  # Reference the providedData for this connection.
        foreign reference RteBswRequiredVariableDataPrototypeRef: set at pre-compile, destination-type=VARIABLE-DATA-PROTOTYPE  # Reference the requiredData for this connection.
        reference RteBswProvidedDataModInstRef: set at pre-compile, destination=RteBswModuleInstance  # Reference to the RteBswModuleInstance configuration container which identifies the instance of the BSW Module. | Used with the RteBswProvidedVariableDataPrototypeRef to unambiguously identify the VariableDataPrototype instance.
      container RteBswRequiredTriggerConnection [0..*]  # Defines the connection between one requiredTrigger of this BSW Module instance and one releasedTrigger instance.
        foreign reference RteBswReleasedTriggerRef: set at pre-compile, destination-type=TRIGGER  # References the releasedTrigger to which this requiredTrigger shall be connected.
        foreign reference RteBswRequiredTriggerRef: set at pre-compile, destination-type=TRIGGER  # References one requiredTrigger which shall be connected to the releasedTrigger.
        reference RteBswReleasedTriggerModInstRef: set at pre-compile, destination=RteBswModuleInstance  # Reference to the RteBswModuleInstance configuration container which identifies the instance of the BSW Module. | Used with the RteBswReleasedTriggerRef to unambiguously identify the Trigger instance.
    container RteDistributedSharedModeQueue [0..*]  # This container holds the configuration of a distributed shared mode queue.
      choice reference RteDSMQModeMachineInstanceRef [1..*]: multiplicity set at pre-compile, set at pre-compile, destination=[RteBswModeMachineInstanceConfig, RteModeMachineInstanceConfig]  # Reference to the mode machine instances which participate in this distributed shared mode queue.
      reference RteDSMQOsTaskRef [1..*]: multiplicity set at pre-compile, set at pre-compile, destination=OsTask  # Reference to the DSMQ transition OsTasks which are used to exclusively schedule on-entry ExecutableEntitys, on-transition ExecutableEntitys, on-exit ExecutableEntitys, and ModeSwitchAck ExecutableEntity activated by mode machine instances of this distributed shared mode queue.
      uri reference RteDSMQResponsibleRipsPluginRef [0..1]: multiplicity set at pre-compile, set at pre-compile, destination-uri=RteRipsPlugin  # Optional reference to the configuration container of the RTE Implementation Plug-in implementing the protection of all mode machine instances assigned to this distributed shared mode queue. Tags: atp.Status=draft
    container RteGeneration  # This container holds the parameters for the configuration of the RTE Generation.
      boolean RteSystemSignalCompuMethodEna: set at pre-compile, default-value=false  # Generate System Signal Compute Methods by RTE. | * true: CompuMethodGen is enable. * false: CompuMethodGen is disabled.
      boolean RteIsrSimplification: set at pre-compile, default-value=false  # Simplification on ISR API used by RTE. | * true: simplification is enabled. * false: no simplification.
      boolean RteEaOptimization: set at pre-compile, default-value=false  # Optimization on ExclusiveArea for RTE communications. WARNING: if optimization is enabled, do NOT invoke any RTE APIs inside an ISR (e.g. CDD)! | * true: optimization is enabled. * false: no optimization.
      boolean RteDevErrorDetect: set at pre-compile, default-value=false  # Switches the development error detection and notification on or off. | * true: detection and notification is enabled. * false: detection and notification is disabled.
      boolean RteDevErrorDetectUninit: set at pre-compile, default-value=false  # The Rte shall detect if it is started when its APIs are called, and the BSW Scheduler shall check if it is initialized when its APIs are called.
      boolean RteInExclusiveAreaCheckEnabled: set at pre-compile, default-value=true  # Enables the check for RTE_E_IN_EXCLUSIVE_AREA (for blocking APIs).
      boolean RteMeasurementSupport: set at pre-compile, default-value=false  # The RTE generator shall have the option to switch off support for measurement for generated RTE code. This option shall influence complete RTE code at once.
      boolean RteValueRangeCheckEnabled: set at pre-compile, default-value=false  # If set to true the RTE generator shall enable the value range checking for the specified VariableDataPrototypes.
      boolean RteVfbTraceEnabled: set at pre-compile, default-value=false  # The RTE generator shall globally enable VFB tracing when RteVfbTrace is set to "true".
      boolean DataMappingGenerationOptimization1To1Rport: set at pre-compile, default-value=false  # The RTE generator shall globally enable DataMapping Generation Optimization with 1:1 Rport when this is set to "true".
      boolean DataMappingGenerationOptimizationNTo1Rport: set at pre-compile, default-value=false  # The RTE generator shall globally enable DataMapping Generation Optimization with N:1 Rport when this is set to "true".
      boolean DataMappingGenerationOptimizationPport: set at pre-compile, default-value=false  # The RTE generator shall globally enable DataMapping Generation Optimization with all period signal-Pport when this is set to "true".
      enumeration RteBypassSupport: {COMPONENT_WRAPPER, EXTENDED_BUFFER_ACCESS, NONE}, set at pre-compile, default-value=NONE  # General switch to enable and select the bypass support method.
      enumeration RteCalibrationSupport: {DOUBLE_POINTERED, INITIALIZED_RAM, NONE, SINGLE_POINTERED}, set at pre-compile, default-value=NONE  # The RTE generator shall have the option to switch off support for calibration for generated RTE code. This option shall influence complete RTE code at once.
      enumeration RteGenerationMode: {COMPATIBILITY_MODE, VENDOR_MODE}, set at pre-compile, default-value=COMPATIBILITY_MODE  # Switch between the two available generation modes of the RTE generator.
      enumeration RteOptimizationMode: {MEMORY, RUNTIME}, set at pre-compile, default-value=RUNTIME  # Switch between the two available optimization modes of the RTE generator.
      function name RteVfbTraceFunction [0..*]: multiplicity set at pre-compile, set at pre-compile  # The RTE generator shall enable VFB tracing for a given hook function when there is a #define in the RTE configuration header file for the hook function name and tracing is globally enabled. | Example: #define Rte_WriteHook_i1_p1_a_Start This also applies to VFB trace functions with a RteVfbTraceClientPrefix, e.g. Rte_Dbg_WriteHook_I1_P1_a_Start.
      integer RteCodeVendorId [0..1]: 0..65535, set at pre-compile  # Holds the vendor ID of the generated Rte code.
      integer RteToolChainSignificantCharacters [0..1]: 0..65535, multiplicity set at pre-compile, set at pre-compile, default-value=31  # If present, the RTE generator shall provide the list of C RTE identifiers whose name is not unique when only the first RteToolChainSignificantCharacters characters are considered.
      linker symbol RteVfbTraceClientPrefix [0..*]: multiplicity set at pre-compile, set at pre-compile  # Defines an additional prefix for all VFB trace functions to be generated. With this approach it is possible to have debugging and DLT trace functions at the same time.
    container RteImplicitCommunication [0..*]  # Configuration of the Implicit Communication behavior to be generated.
      boolean RteCoherentAccess: set at pre-compile, default-value=false  # If set to true the referenced VariableAccess'es of this RteImplicitCommunication container are in one CoherencyGroup. | Data values for Coherent Implicit Read Access'es are read before the first reading RunnbaleEntity starts and are stable during the execution of all the reading RunnableEntitys; except Coherent Implicit Write Access'es belongs to the same Coherency Group. Data values written by Coherent Implicit Write Access'es are available for readers not belonging to the Coherency Group after the last writing RunnableEntity has terminated. Please note that a Coherent Implicit Data Access can be defined for VariableAccess'es to same and different data element. Nevertheless all Coherent Implicit Data Access'es of one Coherency Group have to be executed in the same task.
      boolean RteImmediateBufferUpdate: set at pre-compile, default-value=false  # If set to true the RTE will perform preemption area specific buffer update immediately before (for VariableAccess in the role dataReadAccess) resp. after (for VariableAccess in the role dataWriteAccess) Runnable execution.
      foreign reference RteVariableReadAccessRef [0..*]: multiplicity set at pre-compile, set at pre-compile, destination-type=VARIABLE-ACCESS  # Reference to the VariableAccess in the dataReadAccess role.
      foreign reference RteVariableWriteAccessRef [0..*]: multiplicity set at pre-compile, set at pre-compile, destination-type=VARIABLE-ACCESS  # Reference to the VariableAccess in the dataWriteAccess role.
      instance reference RteSoftwareComponentInstanceRef [1..*]: multiplicity set at pre-compile, set at pre-compile, destination-context=ROOT-SW-COMPOSITION-PROTOTYPE, destination-type=SW-COMPONENT-PROTOTYPE  # Reference to a SwComponentPrototype. | This denotes the instances of the VariableAccess belonging to the RteImplicitCommunication.
    container RteInitializationBehavior [1..*]  # Specifies the initialization strategy for variables allocated by RTE with the purpose to implement VariableDataPrototypes. | The container defines a set of RteSectionInitializationPolicys and one RteInitializationStrategy which is applicable for this set.
      enumeration RteInitializationStrategy: {RTE_INITIALIZATION_STRATEGY_AT_DATA_DECLARATION, RTE_INITIALIZATION_STRATEGY_AT_DATA_DECLARATION_AND_PARTITION_RESTART, RTE_INITIALIZATION_STRATEGY_AT_RTE_START_AND_PARTITION_RESTART, RTE_INITIALIZATION_STRATEGY_NONE}, set at pre-compile  # Definition of the initialization strategy applicable for the SectionInitializationPolicys selected by RteSectionInitializationPolicy.
      string RteSectionInitializationPolicy [1..*]: multiplicity set at pre-compile, set at pre-compile  # This parameter describes the SectionInitializationPolicys for which a particular RTE initialization strategy applies. | The SectionInitializationPolicy describes the intended initialization of MemorySections. The following values are standardized in AUTOSAR Methodology: * '''NO-INIT''': No initialization and no clearing is performed. Such data elements must not be read before one has written a value into it. * '''INIT''': To be used for data that are initialized by every reset to the specified value (initValue). * '''POWER-ON-INIT''': To be used for data that are initialized by "Power On" to the specified value (initValue). Note: there might be several resets between power on resets. * '''CLEARED''': To be used for data that are initialized by every reset to zero. * '''POWER-ON-CLEARED''': To be used for data that are initialized by "Power On" to zero. Note: there might be several resets between power on resets.
    container RteInitializationRunnableBatch [0..*]  # This container corresponds to an Rte_Init_<shortName of this container> function invoking the mapped RunnableEntities.
    container RteOsInteraction [1..*]  # Interaction of the Rte with the Os.
      container RteModeToScheduleTableMapping [0..*]  # Provides configuration input in which Modes of a ModeDeclarionGroupPrototype of a Mode Manager a OsScheudleTable shall be active. | The Mode Manager is either specified as a SwComponentPrototype (RteModeSchtblMapSwc) or as a BSW-Module (RteModeSchtblMapBsw).
        foreign reference RteModeSchtblMapModeDeclarationRef [1..*]: multiplicity set at pre-compile, set at pre-compile, destination-type=MODE-DECLARATION  # Reference to the ModeDeclarations.
        reference RteModeScheduleTableRef: set at pre-compile, destination=OsScheduleTable  # Reference to the OsScheduleTable which shall be active in the specified RteModeSchblMapModeDeclarationRefs.
        container RteModeSchtblMapBsw [0..1]  # Specifies an instance of a ModeDeclarationGroupPrototype of a Bsw-Module.
          foreign reference RteModeSchtblMapBswProvidedModeGroupRef: set at pre-compile, destination-type=MODE-DECLARATION-GROUP-PROTOTYPE  # Reference to an instance of a ModeDeclarationGroupPrototype of a Bsw-Module.
          reference RteModeSchtblMapBswInstanceRef: set at pre-compile, destination=RteBswModuleInstance  # Reference to an instance specification of a Bsw-Module.
        container RteModeSchtblMapSwc [0..1]  # Specifies an instance of a ModeDeclarationGroupPrototype of a SwComponentPrototype.
          foreign reference RteModeSchtblMapSwcPortRef: set at pre-compile, destination-type=ABSTRACT-PROVIDED-PORT-PROTOTYPE  # Reference to the PPortPrototype of a SwComponentPrototype.
          reference RteModeSchtblMapSwcInstanceRef: set at pre-compile, destination=RteSwComponentInstance  # Reference to an instance specification of a SwComponentPrototype.
      container RteOsTaskChain [0..*]  # This container holds the configuration of one task chain configuration.
        reference RtePredecessorOsTaskRef: scope=ECU, set at pre-compile, destination=OsTask  # OsTask which shall chain another OsTask when it terminates.
        reference RteSuccessorOsTaskRef: scope=ECU, set at pre-compile, destination=OsTask  # OsTask which shall be chained from the predecessor OsTask.
      container RteSyncPoint [0..*]  # The RteSyncPoint is necessary to provide an cross core synchronization in case of RteEvents triggered by the same event source but mapped to tasks belonging to different partitions on different cores. | The synchronization point must be reached by all referencing RteEvents before the execution in all related tasks is continued. In case of Rte(Bsw)EventSuccessorSyncPointRef the ExecutableEntity activated by the mapped event is executed before the synchronization point is entered. In case of Rte(Bsw)EventPredecessorSyncPointRef the ExecutableEntity activated by the mapped event is executed after the synchronization point is passed.
      container RteUsedOsActivation [0..*]  # Attributes used in the activation of OsTasks and Runnable Entities.
        float RteExpectedActivationOffset: 0..Inf, set at pre-compile  # Activation offset in milliseconds. | Important: This is a requirement from the Rte towards the Os/Mcu setup. The Rte Generator shall assume this activation offset to be fulfilled.
        float RteExpectedTickDuration: 0..Inf, set at pre-compile  # The expected tick duration in seconds which shall be configured to drive the OsScheduleTables or OsAlarm. | Important: This is a requirement from the Rte towards the Os/Mcu setup. The Rte Generator shall assume this tick duration to be fulfilled.
        reference RteActivationOsAlarmRef [0..1]: multiplicity set at pre-compile, set at pre-compile, destination=OsAlarm  # Reference to an OsAlarm.
        reference RteActivationOsSchTblRef [0..1]: multiplicity set at pre-compile, set at pre-compile, destination=OsScheduleTable  # Reference to an OsScheduleTable.
        reference RteActivationOsTaskRef [0..1]: multiplicity set at pre-compile, set at pre-compile, destination=OsTask  # Reference to an OsTask.
    container RtePostBuildVariantConfiguration [0..1]  # Specifies the PostbuildVariantSets for each of the PostBuild configurations of the RTE.
      foreign reference RtePostBuildUsedPredefinedVariant [1..*]: multiplicity set at post-build in variant post-build / pre-compile in variant pre-compile, post-build-variant-multiplicity=true, post-build-variant-value=true, set at post-build in variant post-build / pre-compile in variant pre-compile, destination-type=PREDEFINED-VARIANT  # Reference to the PredefinedVariant element which defines the values for PostBuildVariationCriterion elements. | The shortName of the referenced PredefinedVariant defines the name of the RtePostBuildVariant.
    container RteRips [0..1]: multiplicity set at pre-compile  # This container provides the configuration of the Rte Implementation Plug-In support by RTE. Tags: atp.Status=draft | If the container is NOT defined, the support for Rte Implementation Plug-Ins (RIPS) is globally disabled.
      enumeration RteRipsSupport: {RTE_RIPS_OFF, RTE_RIPS_ON}, set at pre-compile, default-value=RTE_RIPS_OFF  # Globally enables or disables the support for Rte Implementation Plug-Ins (RIPS) Tags: atp.Status=draft
      uri reference RteRipsPluginConfigurationRef [0..*]: multiplicity set at pre-compile, requires-index=true, set at pre-compile, destination-uri=RteRipsPlugin  # Reference to the configuration container of the RTE Implementation Plug-in holding the RTE relevant settings. Tags: atp.Status=draft | All referenced RTE Implementation Plug-ins are considered for the RTE generation.
    container RteSwComponentInstance [0..*]  # Representation of one SwComponentPrototype located on the to be configured ECU. All subcontainer configuration aspects are in relation to this SwComponentPrototype. | The RteSwComponentInstance can be associated with either a AtomicSwComponentType or ParameterSwComponentType.
      foreign reference RteSoftwareComponentInstanceRef [0..1]: multiplicity set at pre-compile, set at pre-compile, destination-type=SW-COMPONENT-PROTOTYPE  # Reference to a SwComponentPrototype.
      container RteEventToTaskMapping [0..*]  # Maps an instance of a RunnableEntity onto one OsTask based on the activating RTEEvent. | In the case of a RunnableEntity executed via a direct function call this RteEventToTaskMapping is still specified but no RteMappedToTask element is included. The RtePositionInTask parameter is necessary to provide an ordering of events invoked by the same RTE API.
        boolean RteImmediateRestart: set at pre-compile, default-value=false  # When RteImmediateRestart is set to true the RunnableEntitiy shall be immediately re-started after termination if it was activated by this RTEEvent while it was already started. | This parameter shall not be set to true when the mapped RTEEvent refers to a RunnableEntity which minimumStartInterval attribute is > 0.
        enumeration RteOsSchedulePoint [0..1]: {CONDITIONAL, NONE, UNCONDITIONAL}, multiplicity set at pre-compile, set at pre-compile  # Introduce a schedule point by explicitly calling Os Schedule service after the execution of the ExecutableEntity. The Rte generator is allowed to optimize several consecutive calls to Os schedule into one single call if the ExecutableEntity executions in between have been skipped. | The absence of this parameter is interpreted as "NONE". It shall be considered an invalid configuration if the task is preemptable and the value of this parameter is not set to "NONE" or the parameter is absent.
        float RteActivationOffset [0..1]: 0..Inf, multiplicity set at pre-compile, set at pre-compile  # Activation offset in milliseconds.
        integer RtePositionInTask [0..1]: 0..65535, multiplicity set at pre-compile, set at pre-compile  # Each RunnableEntity mapped to an OsTask has a specific position within the task execution. | For periodic activation this is the order of execution. For event driver activation this is the order of evaluation which actual RunnableEntity has to be executed. In case of direct function calls this parameter is necessary to provide an ordering of events when several ExecutableEntities are invoked by the same RTE API.
        integer RteServerQueueLength [0..1]: 0..65535, multiplicity set at pre-compile, set at pre-compile  # Specifies the length of the queue for the server call serialization. This value overwrites the queueLength specified at the ServerComSpec.
        foreign reference RteEventRef [1..*]: set at pre-compile, destination-type=RTE-EVENT  # Reference to the description of the RTEEvent which is pointing to the RunnableEntity being mapped. This allows a fine grained mapping of RunnableEntites based on the activating RTEEvent.
        reference RteEventPredecessorSyncPointRef [0..1]: multiplicity set at pre-compile, set at pre-compile, destination=RteSyncPoint  # The RteEventPredecessorSyncPointRef is necessary to provide a cross core synchronization in case of RteEvents triggered by the same event source but mapped to tasks belonging to different partitions on different cores. | The synchronization point must be reached by all referencing RteEvents before the execution in all related tasks is continued. In case of RteEventPredecessorSyncPointRef the RunnableEntity activated by the mapped RteEvent is executed after the synchronization point is passed.
        reference RteEventSuccessorSyncPointRef [0..1]: multiplicity set at pre-compile, set at pre-compile, destination=RteSyncPoint  # The RteEventSuccessorSyncPointRef is necessary to provide a cross core synchronization in case of RteEvents triggered by the same event source but mapped to tasks belonging to different partitions on different cores. | The synchronization point must be reached by all referencing RteEvents before the execution in all related tasks is continued. In case of RteEventSuccessorSyncPointRef the RunnableEntity activated by the mapped RteEvent is executed before the synchronization point is entered.
        reference RteMappedToTaskRef [0..1]: multiplicity set at pre-compile, set at pre-compile, destination=OsTask  # Reference to the OsTask the RunnableEntity activated by the RteEventRef is mapped to. | If no reference to the OsTask is specified the RunnableEntity shall be executed via a direct function call. The fact that no reference to an OsTask is specified for a RunnableEntity does not necessarily imply that every RTE generator has to support the implementation of this RunnableEntity as a direct function call. The standard set of use cases for direct function calls that has to be supported by every RTE generator is explicitly stated as requirements in this document. For further optimization RTE vendors are free to support additional scenarios of direct function call implementations that are not explicitly required in this document.
        reference RteUsedInitFnc [0..1]: multiplicity set at pre-compile, set at pre-compile, destination=RteInitializationRunnableBatch  # The RunnableEntity is executed during initialization in the context of the Rte_Init_<InitContainer> function.
        reference RteUsedOsAlarmRef [0..1]: multiplicity set at pre-compile, set at pre-compile, destination=OsAlarm  # If an OsAlarm is used to activate the OsTask this RteEvent is mapped to it shall be referenced here.
        reference RteUsedOsEventRef [0..1]: multiplicity set at pre-compile, set at pre-compile, destination=OsEvent  # If an OsEvent is used to activate the OsTask this RteEvent is mapped to it shall be referenced here.
        reference RteUsedOsSchTblExpiryPointRef [0..1]: multiplicity set at pre-compile, set at pre-compile, destination=OsScheduleTableExpiryPoint  # If an OsScheduleTableExpiryPoint is used to activate the OsTask this RteEvent is mapped to it shall be referenced here.
        reference RteVirtuallyMappedToTaskRef [0..1]: multiplicity set at pre-compile, set at pre-compile, destination=OsTask  # Optional reference to an OsTask where the activation of this RteEvent shall be evaluated. The actual execution of the Runnable Entity shall happen in the OsTask referenced by RteMappedToTaskRef.
        uri reference RteRipsFillRoutineRef [0..*]: multiplicity set at pre-compile, requires-index=true, set at pre-compile, destination-uri=RteRipsPluginFillFlushRoutine  # Reference to a Buffer-Fill Routine implemented by an RTE Implementation Plug-In. Tags: atp.Status=draft | This routine gets invoked directly before the ExecutableEntity is started.
        uri reference RteRipsFlushRoutineRef [0..*]: multiplicity set at pre-compile, requires-index=true, set at pre-compile, destination-uri=RteRipsPluginFillFlushRoutine  # Reference to a Buffer-Flush Routine implemented by an RTE Implementation Plug-In. Tags: atp.Status=draft | This routine gets invoked directly after the ExecutableEntity has terminated.
        uri reference RteRipsInvocationHandlerRef [0..1]: multiplicity set at pre-compile, set at pre-compile, destination-uri=RteRipsInvocationHandler  # Reference to a Buffer-Fill Routine implemented by an RTE Implementation Plug-In. Tags: atp.Status=draft | This routine gets invoked directly before the ExecutableEntity is started.
      container RteExclusiveAreaImplementation [0..*]  # Specifies the implementation to be used for the data consistency of this ExclusiveArea.
        enumeration RteExclusiveAreaImplMechanism: {ALL_INTERRUPT_BLOCKING, NONE, OS_INTERRUPT_BLOCKING, OS_RESOURCE, OS_SPINLOCK, RTE_PLUGIN}, set at pre-compile  # To be used implementation mechanism for the specified ExclusiveArea.
        foreign reference RteExclusiveAreaRef: set at pre-compile, destination-type=EXCLUSIVE-AREA  # Reference to the ExclusiveArea.
        reference RteExclusiveAreaOsResourceRef [0..1]: multiplicity set at pre-compile, set at pre-compile, destination=OsResource  # Optional reference to an OsResource in case RteExclusiveAreaImplMechanism is configured to OS_RESOURCE for this ExclusiveArea.
        uri reference RteExclusiveAreaResponsibleRipsPluginRef [0..1]: multiplicity set at pre-compile, set at pre-compile, destination-uri=RteRipsPlugin  # Optional reference to the configuration container of the RTE Implementation Plug-in implementing the ExclusiveArea. Tags: atp.Status=draft | It's required in case RteExclusiveAreaImplMechanism is configured to RTE_PLUGIN for this ExclusiveArea.
      container RteExternalTriggerConfig [0..*]  # Defines the configuration of External Trigger Event Communication for Software Components
        integer RteTriggerSourceQueueLength: 0..4294967295, set at pre-compile, default-value=0  # Length of trigger queue on the trigger source side. | The queue is implemented by the RTE. A value greater or equal to 1 requests an queued behavior. Setting the value of RteTriggerSourceQueueLength to 0 requests an none queued implementation of the trigger communication. If there is no RteTriggerSourceQueueLength configured for a Trigger Emitter the default value of 0 applies as well.
        instance reference RteSwcTriggerSourceRef: set at pre-compile, destination-context=ABSTRACT-PROVIDED-PORT-PROTOTYPE, destination-type=TRIGGER  # Reference to a Trigger instance in the pPortPrototype of the related component instance. | The referenced Trigger instance has to belong to the same software component instance as the RteSwComponentInstance owning this parameter configures.
      container RteInternalTriggerConfig [0..*]  # Defines the configuration of Inter Runnable Triggering for Software Components
        integer RteTriggerSourceQueueLength: 0..4294967295, set at pre-compile, default-value=0  # Length of trigger queue on the trigger source side. | The queue is implemented by the RTE. A value greater or equal to 1 requests an queued behavior. Setting the value of RteTriggerSourceQueueLength to 0 requests an none queued implementation of the trigger communication. If there is no RteTriggerSourceQueueLength configured for a Trigger Emitter the default value of 0 applies as well.
        foreign reference RteSwcTriggerSourceRef: set at pre-compile, destination-type=INTERNAL-TRIGGERING-POINT  # Reference to an InternalTriggeringPoint of the related component instance. | The referenced InternalTriggeringPoint has to belong to the same software component instance as the RteSwComponentInstance owning this parameter configures.
      container RteModeMachineInstanceConfig [0..*]  # Defines the configuration of RTE assigned ( SWS_Rte_07533) mode machine instances.
        integer RteModeMachineQueueLength: 0..4294967295, set at pre-compile, default-value=1  # Length of mode machine instance queue on the trigger source side. | If there is no RteModeMachineQueueLength configured for a mode machine instance the value given in the ModeSwitchSenderComSpec.queueLength applies.
        instance reference RteSwcModeManagerRef: set at pre-compile, destination-context=ABSTRACT-PROVIDED-PORT-PROTOTYPE, destination-type=MODE-DECLARATION-GROUP-PROTOTYPE  # Reference to a ModeDeclarationGroupPrototype instance in the provided PortPrototype (AbstractProvidedPortPrototype) of the related component instance. | The referenced ModeDeclarationGroupPrototype instance has to belong to the same software component instance as the RteSwComponentInstance owning this parameter configures.
        uri reference RteModeMachineInstanceResponsibleRipsPluginRef [0..1]: multiplicity set at pre-compile, set at pre-compile, destination-uri=RteRipsPlugin  # Optional reference to the configuration container of the RTE Implementation Plug-in implementing the protection of the mode machine instance. Tags: atp.Status=draft
      container RteNvRamAllocation [0..*]  # Specifies the relationship between the AtomicSwComponentType's NVRAMMapping / NVRAM needs and the NvM module configuration.
        linker symbol RteNvmRamBlockLocationSymbol [0..1]: multiplicity set at pre-compile, set at pre-compile  # This is the name of the linker object name where the NVRam Block will be mirrored by the Nvm. | This symbol will be resolved into the parameter "NvmRamBlockDataAddress" from the "NvmBlockDescriptor".
        linker symbol RteNvmRomBlockLocationSymbol [0..1]: multiplicity set at pre-compile, set at pre-compile  # This is the name of the linker object name where the NVRom Block will be accessed by the Nvm. | This symbol will be resolved into the parameter "NvmRomBlockDataAddress" from the "NvmBlockDescriptor".
        foreign reference RteSwNvBlockDescriptorRef [0..1]: multiplicity set at pre-compile, set at pre-compile, destination-type=NV-BLOCK-DESCRIPTOR  # Reference to the NvBlockDescriptor in case the RTE needs to call the NvM directly (e.g. for the supportDirtyFlag feature, storeCyclic feature, server invocation for NV data management or mode switch based invocation NvM services).
        foreign reference RteSwNvRamMappingRef [0..1]: multiplicity set at pre-compile, set at pre-compile, destination-type=SWC-SERVICE-DEPENDENCY  # Reference to the SwSeriveDependency which is used to specify the NvBlockNeeds. | XOR
        reference RteNvmBlockRef: set at pre-compile, requires-symbolic-name-value=true, destination=NvMBlockDescriptor  # Reference to the used NvM block for storage of the NVRAMMapping information.
    container RteSwComponentType [0..*]  # Representation of one SwComponentType for the base of all configuration parameter which are affecting the whole type and not a specific instance.
      boolean RteBypassSupportEnabled [0..1]: multiplicity set at pre-compile, set at pre-compile, default-value=false  # Individual switch to enable the bypass support for this software component type.
      foreign reference RteComponentTypeRef: set at pre-compile, destination-type=SW-COMPONENT-TYPE  # Reference to either AtomicSwComponentType or ParameterSwComponentType.
      foreign reference RteImplementationRef [0..1]: multiplicity set at pre-compile, set at pre-compile, destination-type=SWC-IMPLEMENTATION  # The Implementation which shall be assigned to the SwComponentType.
      container RteComponentTypeCalibration [0..1]  # Specifies for each ParameterSwComponentType or AtomicSwComponentType whether calibration is enabled. | If references to SwAddrMethod are provided in RteCalibrationSwAddrMethodRef only ParameterDataPrototypes with the referenced SwAddrMethod shall have software calibration support enabled.
        boolean RteCalibrationSupportEnabled: set at pre-compile  # Enables calibration support for the specified ParameterSwComponentType or AtomicSwComponentType.
        foreign reference RteCalibrationSwAddrMethodRef [0..*]: multiplicity set at pre-compile, set at pre-compile, destination-type=SW-ADDR-METHOD  # Reference to the SwAddrMethod for which software calibration support shall be enabled.
package /AUTOSAR/EcucDestinationUriDefSets
  ecuc destination uri def set RteRipsUriDefSet
    ecuc destination uri def RteRipsInvocationHandler
      destination-uri-policy destination-uri-nesting-contract=TARGET-CONTAINER:
        container RteRipsInvocationHandlerFnc [0..*]  # This container describes an invocation handler function implemented by an RTE Implementation Plug-In to handle the invocation of server runnables and triggered runnables via a transformer. Tags: atp.Status=draft
          function name RteRipsInvocationHandlerFncSymbol  # C-Symbol of the Rte_Rips_FillFlushRoutine function. Tags: atp.Status=draft
    ecuc destination uri def RteRipsPlugin
      destination-uri-policy destination-uri-nesting-contract=TARGET-CONTAINER:
        container RteRipsPluginProps  # This container defines the identity of the Rte Implementation Plug-in and provides the RTE relevant parameters of the Rte Implementation Plug-in. Tags: atp.Status=draft | The shortName of the container defines the name of the Rte Implementation Plug-in used for the API infixes.
          boolean RtePluginSupportsIReadIWrite: default-value=false  # Denotes if or if not the plug-in supports the Rte_Rips_IRead/IWrite macros for primitive data. Tags: atp.Status=draft
          enumeration RteRipsGlobalCopyInstantiationPolicy: {RTE_RIPS_INSTANTIATION_BY_PLUGIN, RTE_RIPS_INSTANTIATION_BY_RTE}, default-value=RTE_RIPS_INSTANTIATION_BY_RTE  # Globally enables or disables the support for Rte Implementation Plug-Ins (RIPS) Tags: atp.Status=draft
    ecuc destination uri def RteRipsPluginFillFlushRoutine
      destination-uri-policy destination-uri-nesting-contract=TARGET-CONTAINER:
        container RteRipsPluginFillFlushRoutineFnc [0..*]  # This container describes a Fill-Flush Routine function implemented by a RTE Implementation Plug-In to handle the buffering for implicit communication. Tags: atp.Status=draft
          enumeration RteRipsModeDisablingHandling: {RTE_RIPS_CONSIDER_MODE_DISABLINGS, RTE_RIPS_IGNORE_MODE_DISABLINGS}  # This parameter configures whether mode disabling dependencies are considered for the invocation of Rte_Rips_FillFlushRoutines. Tags: atp.Status=draft
          enumeration RteRipsOsSchedulePoint [0..1]: {NONE, UNCONDITIONAL}  # Introduce a schedule point by explicitly calling Os Schedule service after the execution of the Rte_Rips_FillFlushRoutine. Tags: atp.Status=draft
          function name RteRipsPluginFillFlushRoutineFncSymbol  # C-Symbol of the Rte_Rips_FillFlushRoutine function. Tags: atp.Status=draft
package /AUTOSAR/LifeCycleInfoSets
  life cycle info set AUTOSARParameterDefinition
    life-cycle-infos:
      lc-object=AdcGroupEcucPartitionRef, lc-state=draft
      lc-object=AdcEcucPartitionRef, lc-state=draft
      lc-object=AdcKernelEcucPartitionRef, lc-state=draft
      lc-object=ArtiConstant, lc-state=draft
      lc-object=ArtiConstantString, lc-state=draft
      lc-object=ArtiExpression, lc-state=draft
      lc-object=ArtiExpressionString, lc-state=draft
      lc-object=ArtiHook, lc-state=draft
      lc-object=ArtiHookClass, lc-state=draft
      lc-object=ArtiHookEventName, lc-state=draft
      lc-object=ArtiHookInstance, lc-state=draft
      lc-object=ArtiHookEventParameterTypeRef, lc-state=draft
      lc-object=ArtiHookInstanceParameterTypeRef, lc-state=draft
      lc-object=ArtiObjectClassParameter, lc-state=draft
      lc-object=ArtiParameterTypeMapRef, lc-state=draft
      lc-object=ArtiObjectInstanceParameter, lc-state=draft
      lc-object=ArtiConstantRef, lc-state=draft
      lc-object=ArtiExpressionRef, lc-state=draft
      lc-object=ArtiHookRef, lc-state=draft
      lc-object=ArtiParameterTypeMap, lc-state=draft
      lc-object=ArtiParameterTypeMapPair, lc-state=draft
      lc-object=ArtiParameterTypeMapPairInput, lc-state=draft
      lc-object=ArtiParameterTypeMapPairOutput, lc-state=draft
      lc-object=ArtiGenericComponentClass, lc-state=draft
      lc-object=ArtiGenericComponentClassName, lc-state=draft
      lc-object=ArtiGenericComponentClassParameter, lc-state=draft
      lc-object=ArtiGenericComponentClassParameterName, lc-state=draft
      lc-object=ArtiParameterTypeMapRef, lc-state=draft
      lc-object=ArtiGenericComponentInstance, lc-state=draft
      lc-object=ArtiGenericComponentInstanceName, lc-state=draft
      lc-object=ArtiGenericComponentClassRef, lc-state=draft
      lc-object=ArtiGenericComponentInstanceParameter, lc-state=draft
      lc-object=ArtiConstantRef, lc-state=draft
      lc-object=ArtiExpressionRef, lc-state=draft
      lc-object=ArtiGenericComponentClassParameterRef, lc-state=draft
      lc-object=ArtiHookRef, lc-state=draft
      lc-object=ArtiHwCoreClass, lc-state=draft
      lc-object=ArtiCurrentApplicationClassRef, lc-state=draft
      lc-object=ArtiCurrentTaskClassRef, lc-state=draft
      lc-object=ArtiLastErrorClassRef, lc-state=draft
      lc-object=ArtiHwCoreInstance, lc-state=draft
      lc-object=ArtiCurrentApplicationInstanceRef, lc-state=draft
      lc-object=ArtiCurrentTaskInstanceRef, lc-state=draft
      lc-object=ArtiEcucCoreRef, lc-state=draft
      lc-object=ArtiLastErrorInstanceRef, lc-state=draft
      lc-object=ArtiOsClass, lc-state=draft
      lc-object=ArtiOsAppModeClassRef, lc-state=draft
      lc-object=ArtiOsInstance, lc-state=draft
      lc-object=ArtiOsAppModeEcucRef, lc-state=draft
      lc-object=ArtiOsAppModeInstanceRef, lc-state=draft
      lc-object=ArtiOsEcucRef, lc-state=draft
      lc-object=ArtiOsTaskHookRef, lc-state=draft
      lc-object=ArtiOsTaskClass, lc-state=draft
      lc-object=ArtiOsTaskInstance, lc-state=draft
      lc-object=ArtiGenericComponentInstanceRef, lc-state=draft
      lc-object=ArtiOsTaskEcucRef, lc-state=draft
      lc-object=CanControllerEcucPartitionRef, lc-state=draft
      lc-object=CanTTControllerEcucPartitionRef, lc-state=draft
      lc-object=CanEcucPartitionRef, lc-state=draft
      lc-object=CanTSynGlobalTimeSecureTmacLength, lc-state=draft
      lc-object=CanTSynTxTmacCalculated, lc-state=draft
      lc-object=CanTSynGlobalTimeMinMsgGap, lc-state=draft
      lc-object=CanTSynRxTmacValidated, lc-state=draft
      lc-object=CanTrcvChannelEcucPartitionRef, lc-state=draft
      lc-object=CanTrcvEcucPartitionRef, lc-state=draft
      lc-object=CorTstBackgroundEcucPartitionRef, lc-state=draft
      lc-object=CorTstForegroundEcucPartitionRef, lc-state=draft
      lc-object=CorTstEcucPartitionRef, lc-state=draft
      lc-object=CryptoDriverObjectEcucPartitionRef, lc-state=draft
      lc-object=CryptoEcucPartitionRef, lc-state=draft
      lc-object=DemFreezeFrameRecordTrigger, lc-state=draft
      lc-object=DioPortEcucPartitionRef, lc-state=draft
      lc-object=DioChannelEcucPartitionRef, lc-state=draft
      lc-object=DioChannelGroupEcucPartitionRef, lc-state=draft
      lc-object=DioEcucPartitionRef, lc-state=draft
      lc-object=EepEcucPartitionRef, lc-state=draft
      lc-object=EthCtrlEcucPartitionRef, lc-state=draft
      lc-object=EthEcucPartitionRef, lc-state=draft
      lc-object=EthSwtConfigEcucPartitionRef, lc-state=draft
      lc-object=EthSwtEcucPartitionRef, lc-state=draft
      lc-object=EthTSynGlobalTimeSecureTmacLength, lc-state=draft
      lc-object=EthTSynGlobalTimeMinMsgGap, lc-state=draft
      lc-object=EthTSynTxTmacCalculated, lc-state=draft
      lc-object=EthTSynRxTmacValidated, lc-state=draft
      lc-object=EthTrcvConfigEcucPartitionRef, lc-state=draft
      lc-object=EthTrcvEcucPartitionRef, lc-state=draft
      lc-object=FlsEcucPartitionRef, lc-state=draft
      lc-object=FlsTstEcucPartitionRef, lc-state=draft
      lc-object=FrEcucPartitionRef, lc-state=draft
      lc-object=FrCtrlEcucPartitionRef, lc-state=draft
      lc-object=FrTSynGlobalTimeSecureTmacLength, lc-state=draft
      lc-object=FrTSynUseExtendedMsgFormat, lc-state=draft
      lc-object=FrTSynTxTmacCalculated, lc-state=draft
      lc-object=FrTSynGlobalTimeMinMsgGap, lc-state=draft
      lc-object=FrTSynGlobalTimeTmacTimeout, lc-state=draft
      lc-object=FrTSynRxTmacValidated, lc-state=draft
      lc-object=FrTrcvChannelEcucPartitionRef, lc-state=draft
      lc-object=FrTrcvEcucPartitionRef, lc-state=draft
      lc-object=GptChannelEcucPartitionRef, lc-state=draft
      lc-object=GptEcucPartitionRef, lc-state=draft
      lc-object=GptKernelEcucPartitionRef, lc-state=draft
      lc-object=IcuChannelEcucPartitionRef, lc-state=draft
      lc-object=IcuEcucPartitionRef, lc-state=draft
      lc-object=IcuKernelEcucPartitionRef, lc-state=draft
      lc-object=IpduMContainedPduOffset, lc-state=draft
      lc-object=IpduMPduUpdateBitPosition, lc-state=draft
      lc-object=IpduMContainedPduOffset, lc-state=draft
      lc-object=IpduMPduUpdateBitPosition, lc-state=draft
      lc-object=IPDUM_HEADERTYPE_NONE, lc-state=draft
      lc-object=IPDUM_HEADERTYPE_NONE, lc-state=draft
      lc-object=IpduMUnusedAreasDefault, lc-state=draft
      lc-object=LinEcucPartitionRef, lc-state=draft
      lc-object=LinChannelEcucPartitionRef, lc-state=draft
      lc-object=LinTrcvChannelEcucPartitionRef, lc-state=draft
      lc-object=LinTrcvEcucPartitionRef, lc-state=draft
      lc-object=McuEcucPartitionRef, lc-state=draft
      lc-object=OcuChannelEcucPartitionRef, lc-state=draft
      lc-object=OcuEcucPartitionRef, lc-state=draft
      lc-object=OcuKernelEcucPartitionRef, lc-state=draft
      lc-object=PortPinEcucPartitionRef, lc-state=draft
      lc-object=PortEcucPartitionRef, lc-state=draft
      lc-object=PwmChannelEcucPartitionRef, lc-state=draft
      lc-object=PwmEcucPartitionRef, lc-state=draft
      lc-object=PwmKernelEcucPartitionRef, lc-state=draft
      lc-object=RamTstEcucPartitionRef, lc-state=draft
      lc-object=RamTstBlockParamsEcucPartitionRef, lc-state=draft
      lc-object=RteEventToTaskMapping/RteRipsFillRoutineRef, lc-state=draft
      lc-object=RteEventToTaskMapping/RteRipsFlushRoutineRef, lc-state=draft
      lc-object=RteBswExclusiveAreaResponsibleRipsPluginRef, lc-state=draft
      lc-object=RteModeMachineInstanceConfig/RteModeMachineInstanceResponsibleRipsPluginRef, lc-state=draft
      lc-object=RteDSMQResponsibleRipsPluginRef, lc-state=draft
      lc-object=RteRips, lc-state=draft
      lc-object=RteRipsSupport, lc-state=draft
      lc-object=RteRipsPluginConfigurationRef, lc-state=draft
      lc-object=RteEventToTaskMapping/RteRipsFillRoutineRef, lc-state=draft
      lc-object=RteEventToTaskMapping/RteRipsFlushRoutineRef, lc-state=draft
      lc-object=RteRipsInvocationHandlerRef, lc-state=draft
      lc-object=RteExclusiveAreaResponsibleRipsPluginRef, lc-state=draft
      lc-object=RteModeMachineInstanceConfig/RteModeMachineInstanceResponsibleRipsPluginRef, lc-state=draft
      lc-object=SoAdSocketTcpTlsConnectionRef, lc-state=draft
      lc-object=SpiDeviceEcucPartitionRef, lc-state=draft
      lc-object=SpiEcucPartitionRef, lc-state=draft
      lc-object=SpiKernelEcucPartitionRef, lc-state=draft
      lc-object=TcpIpTlsConfig, lc-state=draft
      lc-object=TcpIpTlsMaxConnections, lc-state=draft
      lc-object=TcpIpTlsCsmRandomGenerateJobRef, lc-state=draft
      lc-object=TcpIpTlsCiphersuites, lc-state=draft
      lc-object=TcpIpTlsCertificateIdentity, lc-state=draft
      lc-object=TcpIpTlsServerNameIdentification, lc-state=draft
      lc-object=TcpIpTlsCiphersuiteDefinition, lc-state=draft
      lc-object=TcpIpTlsCiphersuiteId, lc-state=draft
      lc-object=TcpIpTlsCiphersuiteName, lc-state=draft
      lc-object=TcpIpTlsCiphersuitePriority, lc-state=draft
      lc-object=TcpIpTlsUseAEADCipher, lc-state=draft
      lc-object=TcpIpTlsUsePresharedKeys, lc-state=draft
      lc-object=TcpIpTlsUseSecurityExtensionForceMacThenHash, lc-state=draft
      lc-object=TcpIpTlsVersion, lc-state=draft
      lc-object=TcpIpTlsCiphersuiteWorker, lc-state=draft
      lc-object=TcpIpTlsCipherAEADCipherKeyLength, lc-state=draft
      lc-object=TcpIpTlsCipherEncryptKeyLength, lc-state=draft
      lc-object=TcpIpTlsCipherMacKeyLength, lc-state=draft
      lc-object=TcpIpTlsCipherCsmDecryptJobRef, lc-state=draft
      lc-object=TcpIpTlsCipherCsmDecryptKeyRef, lc-state=draft
      lc-object=TcpIpTlsCipherCsmEncryptJobRef, lc-state=draft
      lc-object=TcpIpTlsCipherCsmEncryptKeyRef, lc-state=draft
      lc-object=TcpIpTlsCipherCsmMacGenerateJobRef, lc-state=draft
      lc-object=TcpIpTlsCipherCsmMacGenerateKeyRef, lc-state=draft
      lc-object=TcpIpTlsCipherCsmMacVerifyJobRef, lc-state=draft
      lc-object=TcpIpTlsCipherCsmMacVerifyKeyRef, lc-state=draft
      lc-object=TcpIpTlsCiphersuiteDefinitionRef, lc-state=draft
      lc-object=TcpIpTlsConnectionHandshakeRef, lc-state=draft
      lc-object=TcpIpTlsHandshake, lc-state=draft
      lc-object=TcpIpTlsCsmPRFSupportType, lc-state=draft
      lc-object=TcpIpTlsCsmHashVerifyJobRef, lc-state=draft
      lc-object=TcpIpTlsCsmKeyExchangeCalcPubValJobRef, lc-state=draft
      lc-object=TcpIpTlsCsmKeyExchangeCalcSecretJobRef, lc-state=draft
      lc-object=TcpIpTlsCsmKeyExchangeDecryptJobRef, lc-state=draft
      lc-object=TcpIpTlsCsmKeyExchangeDecryptKeyRef, lc-state=draft
      lc-object=TcpIpTlsCsmKeyExchangeEncryptJobRef, lc-state=draft
      lc-object=TcpIpTlsCsmKeyExchangeEncryptKeyRef, lc-state=draft
      lc-object=TcpIpTlsCsmKeyExchangeKeyRef, lc-state=draft
      lc-object=TcpIpTlsCsmKeyExchangeSignatureGenerateJobRef, lc-state=draft
      lc-object=TcpIpTlsCsmKeyExchangeSignatureGenerateKeyRef, lc-state=draft
      lc-object=TcpIpTlsCsmKeyExchangeSignatureVerifyJobRef, lc-state=draft
      lc-object=TcpIpTlsCsmKeyExchangeSignatureVerifyKeyRef, lc-state=draft
      lc-object=TcpIpTlsCsmMasterSecretKeyRef, lc-state=draft
      lc-object=TcpIpTlsCsmPrfMacJobRef, lc-state=draft
      lc-object=TcpIpTlsCsmPrfMacKeyRef, lc-state=draft
      lc-object=TcpIpTlsPskIdentity, lc-state=draft
      lc-object=TcpIpTlsPresharedKeyIdentity, lc-state=draft
      lc-object=TcpIpTlsPresharedKeyIdentityHint, lc-state=draft
      lc-object=TcpIpTlsPskGetClientKeyIdentityFunc, lc-state=draft
      lc-object=TcpIpTlsPskGetKeyIdentyHintFunc, lc-state=draft
      lc-object=TcpIpTlsPskGetServerKeyIdentityFunc, lc-state=draft
      lc-object=TcpIpTlsPresharedKeyCsmKeyRef, lc-state=draft
      lc-object=TcpIpTlsConnection, lc-state=draft
      lc-object=TcpIpTlsConnectionGetTimeFunc, lc-state=draft
      lc-object=TcpIpTlsConnectionId, lc-state=draft
      lc-object=TcpIpTlsConnectionType, lc-state=draft
      lc-object=TcpIpTlsMaxFragmentLength, lc-state=draft
      lc-object=TcpIpTlsPortAssignment, lc-state=draft
      lc-object=TcpIpTlsUseClientAuthenticationRequest, lc-state=draft
      lc-object=TcpIpTlsUseSecurityExtensionRecordSizeLimit, lc-state=draft
      lc-object=TcpIpTlsCertificateIdentityRef, lc-state=draft
      lc-object=TcpIpTlsConnectionCiphersuiteWorkerRef, lc-state=draft
      lc-object=TcpIpTlsConnectionGroupRef, lc-state=draft
      lc-object=TcpIpTlsConnectionPskIdentityRef, lc-state=draft
      lc-object=TcpIpTlsIpAddressAssignment, lc-state=draft
      lc-object=TcpIpTlsConnectionGroup, lc-state=draft
      lc-object=WEthCtrlEcucPartitionRef, lc-state=draft
      lc-object=WEthEcucPartitionRef, lc-state=draft
      lc-object=WEthTrcvConfigEcucPartitionRef, lc-state=draft
      lc-object=WEthTrcvEcucPartitionRef, lc-state=draft
      lc-object=WdgEcucPartitionRef, lc-state=draft
