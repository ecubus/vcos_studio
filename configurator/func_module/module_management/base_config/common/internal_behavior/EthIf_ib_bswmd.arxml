AUTOSAR XML (schema 00046)
package /AUTOSAR/EthIf_ib_bswmd/BswModuleDescriptions
  bsw module description EthIf: provided-entrys=EthIf_MainFunctionRx
    bsw internal behavior EthIfBehavior
      bsw schedulable entity EthIf_MainFunctionRx: implemented-entry=EthIf_MainFunctionRx
      bsw timing event EthIf_MainFunctionRxTimingEvent0: starts-on-event=EthIf_MainFunctionRx, period=0.005
  bsw module entry EthIf_MainFunctionRx: call-type=SCHEDULED, execution-context=TASK
