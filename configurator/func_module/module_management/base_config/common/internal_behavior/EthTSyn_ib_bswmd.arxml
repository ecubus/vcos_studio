AUTOSAR XML (schema 00046)
package /AUTOSAR/EthTSyn_ib_bswmd/BswModuleDescriptions
  bsw module description EthTSyn: provided-entrys=EthTSyn_MainFunction
    bsw internal behavior EthTSynBehavior
      bsw schedulable entity EthTSyn_MainFunction: implemented-entry=EthTSyn_MainFunction
      bsw timing event EthTSyn_MainFunctionTimingEvent0: starts-on-event=EthTSyn_MainFunction, period=0.005
  bsw module entry EthTSyn_MainFunction: call-type=SCHEDULED, execution-context=TASK
