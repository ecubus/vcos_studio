AUTOSAR XML (schema 00046)
package /AUTOSAR/TcpIp_ib_bswmd/BswModuleDescriptions
  bsw module description TcpIp: provided-entrys=tcpip_main_function
    bsw internal behavior TcpIpBehavior
      bsw schedulable entity tcpip_main_function: implemented-entry=tcpip_main_function
      bsw timing event TcpIp_MainFunctionTimingEvent0: starts-on-event=tcpip_main_function, period=0.005
  bsw module entry tcpip_main_function: call-type=SCHEDULED, execution-context=TASK
